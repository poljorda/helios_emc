VERSION ""

NS_ :

BS_:

BU_: IOT_Gateway BMC

BO_ 112 RatChaCellBattPwrHi_1: 64 BMC
 SG_ RatChaCellBattPwrHi_2_16 : 496|16@1+ (0.0030517578125,0) [0|199.996948242188] ""  IOT_Gateway
 SG_ RatChaCellBattPwrHi_2_15 : 480|16@1+ (0.0030517578125,0) [0|199.996948242188] ""  IOT_Gateway
 SG_ RatChaCellBattPwrHi_2_14 : 464|16@1+ (0.0030517578125,0) [0|199.996948242188] ""  IOT_Gateway
 SG_ RatChaCellBattPwrHi_2_13 : 448|16@1+ (0.0030517578125,0) [0|199.996948242188] ""  IOT_Gateway
 SG_ RatChaCellBattPwrHi_2_12 : 432|16@1+ (0.0030517578125,0) [0|199.996948242188] ""  IOT_Gateway
 SG_ RatChaCellBattPwrHi_2_11 : 416|16@1+ (0.0030517578125,0) [0|199.996948242188] ""  IOT_Gateway
 SG_ RatChaCellBattPwrHi_2_10 : 400|16@1+ (0.0030517578125,0) [0|199.996948242188] ""  IOT_Gateway
 SG_ RatChaCellBattPwrHi_2_9 : 384|16@1+ (0.0030517578125,0) [0|199.996948242188] ""  IOT_Gateway
 SG_ RatChaCellBattPwrHi_2_8 : 368|16@1+ (0.0030517578125,0) [0|199.996948242188] ""  IOT_Gateway
 SG_ RatChaCellBattPwrHi_2_7 : 352|16@1+ (0.0030517578125,0) [0|199.996948242188] ""  IOT_Gateway
 SG_ RatChaCellBattPwrHi_2_6 : 336|16@1+ (0.0030517578125,0) [0|199.996948242188] ""  IOT_Gateway
 SG_ RatChaCellBattPwrHi_2_5 : 320|16@1+ (0.0030517578125,0) [0|199.996948242188] ""  IOT_Gateway
 SG_ RatChaCellBattPwrHi_2_4 : 304|16@1+ (0.0030517578125,0) [0|199.996948242188] ""  IOT_Gateway
 SG_ RatChaCellBattPwrHi_2_3 : 288|16@1+ (0.0030517578125,0) [0|199.996948242188] ""  IOT_Gateway
 SG_ RatChaCellBattPwrHi_2_2 : 272|16@1+ (0.0030517578125,0) [0|199.996948242188] ""  IOT_Gateway
 SG_ RatChaCellBattPwrHi_2_1 : 256|16@1+ (0.0030517578125,0) [0|199.996948242188] ""  IOT_Gateway
 SG_ RatChaCellBattPwrHi_1_16 : 240|16@1+ (0.0030517578125,0) [0|199.996948242188] ""  IOT_Gateway
 SG_ RatChaCellBattPwrHi_1_15 : 224|16@1+ (0.0030517578125,0) [0|199.996948242188] ""  IOT_Gateway
 SG_ RatChaCellBattPwrHi_1_14 : 208|16@1+ (0.0030517578125,0) [0|199.996948242188] ""  IOT_Gateway
 SG_ RatChaCellBattPwrHi_1_13 : 192|16@1+ (0.0030517578125,0) [0|199.996948242188] ""  IOT_Gateway
 SG_ RatChaCellBattPwrHi_1_12 : 176|16@1+ (0.0030517578125,0) [0|199.996948242188] ""  IOT_Gateway
 SG_ RatChaCellBattPwrHi_1_11 : 160|16@1+ (0.0030517578125,0) [0|199.996948242188] ""  IOT_Gateway
 SG_ RatChaCellBattPwrHi_1_10 : 144|16@1+ (0.0030517578125,0) [0|199.996948242188] ""  IOT_Gateway
 SG_ RatChaCellBattPwrHi_1_9 : 128|16@1+ (0.0030517578125,0) [0|199.996948242188] ""  IOT_Gateway
 SG_ RatChaCellBattPwrHi_1_8 : 112|16@1+ (0.0030517578125,0) [0|199.996948242188] ""  IOT_Gateway
 SG_ RatChaCellBattPwrHi_1_7 : 96|16@1+ (0.0030517578125,0) [0|199.996948242188] ""  IOT_Gateway
 SG_ RatChaCellBattPwrHi_1_6 : 80|16@1+ (0.0030517578125,0) [0|199.996948242188] ""  IOT_Gateway
 SG_ RatChaCellBattPwrHi_1_5 : 64|16@1+ (0.0030517578125,0) [0|199.996948242188] ""  IOT_Gateway
 SG_ RatChaCellBattPwrHi_1_4 : 48|16@1+ (0.0030517578125,0) [0|199.996948242188] ""  IOT_Gateway
 SG_ RatChaCellBattPwrHi_1_3 : 32|16@1+ (0.0030517578125,0) [0|199.996948242188] ""  IOT_Gateway
 SG_ RatChaCellBattPwrHi_1_2 : 16|16@1+ (0.0030517578125,0) [0|199.996948242188] ""  IOT_Gateway
 SG_ RatChaCellBattPwrHi_1_1 : 0|16@1+ (0.0030517578125,0) [0|199.996948242188] ""  IOT_Gateway

BO_ 107 TCellBattEgyHi_12: 12 BMC
 SG_ TCellBattEgyHi_12_6 : 80|16@1+ (0.0078125,0) [0|511.9921875] "°K"  IOT_Gateway
 SG_ TCellBattEgyHi_12_5 : 64|16@1+ (0.0078125,0) [0|511.9921875] "°K"  IOT_Gateway
 SG_ TCellBattEgyHi_12_4 : 48|16@1+ (0.0078125,0) [0|511.9921875] "°K"  IOT_Gateway
 SG_ TCellBattEgyHi_12_3 : 32|16@1+ (0.0078125,0) [0|511.9921875] "°K"  IOT_Gateway
 SG_ TCellBattEgyHi_12_2 : 16|16@1+ (0.0078125,0) [0|511.9921875] "°K"  IOT_Gateway
 SG_ TCellBattEgyHi_12_1 : 0|16@1+ (0.0078125,0) [0|511.9921875] "°K"  IOT_Gateway

BO_ 106 TCellBattEgyHi_11: 12 BMC
 SG_ TCellBattEgyHi_11_6 : 80|16@1+ (0.0078125,0) [0|511.9921875] "°K"  IOT_Gateway
 SG_ TCellBattEgyHi_11_5 : 64|16@1+ (0.0078125,0) [0|511.9921875] "°K"  IOT_Gateway
 SG_ TCellBattEgyHi_11_4 : 48|16@1+ (0.0078125,0) [0|511.9921875] "°K"  IOT_Gateway
 SG_ TCellBattEgyHi_11_3 : 32|16@1+ (0.0078125,0) [0|511.9921875] "°K"  IOT_Gateway
 SG_ TCellBattEgyHi_11_2 : 16|16@1+ (0.0078125,0) [0|511.9921875] "°K"  IOT_Gateway
 SG_ TCellBattEgyHi_11_1 : 0|16@1+ (0.0078125,0) [0|511.9921875] "°K"  IOT_Gateway

BO_ 105 TCellBattEgyHi_10: 12 BMC
 SG_ TCellBattEgyHi_10_6 : 80|16@1+ (0.0078125,0) [0|511.9921875] "°K"  IOT_Gateway
 SG_ TCellBattEgyHi_10_5 : 64|16@1+ (0.0078125,0) [0|511.9921875] "°K"  IOT_Gateway
 SG_ TCellBattEgyHi_10_4 : 48|16@1+ (0.0078125,0) [0|511.9921875] "°K"  IOT_Gateway
 SG_ TCellBattEgyHi_10_3 : 32|16@1+ (0.0078125,0) [0|511.9921875] "°K"  IOT_Gateway
 SG_ TCellBattEgyHi_10_2 : 16|16@1+ (0.0078125,0) [0|511.9921875] "°K"  IOT_Gateway
 SG_ TCellBattEgyHi_10_1 : 0|16@1+ (0.0078125,0) [0|511.9921875] "°K"  IOT_Gateway

BO_ 104 TCellBattEgyHi_9: 12 BMC
 SG_ TCellBattEgyHi_9_6 : 80|16@1+ (0.0078125,0) [0|511.9921875] "°K"  IOT_Gateway
 SG_ TCellBattEgyHi_9_5 : 64|16@1+ (0.0078125,0) [0|511.9921875] "°K"  IOT_Gateway
 SG_ TCellBattEgyHi_9_4 : 48|16@1+ (0.0078125,0) [0|511.9921875] "°K"  IOT_Gateway
 SG_ TCellBattEgyHi_9_3 : 32|16@1+ (0.0078125,0) [0|511.9921875] "°K"  IOT_Gateway
 SG_ TCellBattEgyHi_9_2 : 16|16@1+ (0.0078125,0) [0|511.9921875] "°K"  IOT_Gateway
 SG_ TCellBattEgyHi_9_1 : 0|16@1+ (0.0078125,0) [0|511.9921875] "°K"  IOT_Gateway

BO_ 103 TCellBattEgyHi_8: 12 BMC
 SG_ TCellBattEgyHi_8_6 : 80|16@1+ (0.0078125,0) [0|511.9921875] "°K"  IOT_Gateway
 SG_ TCellBattEgyHi_8_5 : 64|16@1+ (0.0078125,0) [0|511.9921875] "°K"  IOT_Gateway
 SG_ TCellBattEgyHi_8_4 : 48|16@1+ (0.0078125,0) [0|511.9921875] "°K"  IOT_Gateway
 SG_ TCellBattEgyHi_8_3 : 32|16@1+ (0.0078125,0) [0|511.9921875] "°K"  IOT_Gateway
 SG_ TCellBattEgyHi_8_2 : 16|16@1+ (0.0078125,0) [0|511.9921875] "°K"  IOT_Gateway
 SG_ TCellBattEgyHi_8_1 : 0|16@1+ (0.0078125,0) [0|511.9921875] "°K"  IOT_Gateway

BO_ 102 TCellBattEgyHi_7: 12 BMC
 SG_ TCellBattEgyHi_7_6 : 80|16@1+ (0.0078125,0) [0|511.9921875] "°K"  IOT_Gateway
 SG_ TCellBattEgyHi_7_5 : 64|16@1+ (0.0078125,0) [0|511.9921875] "°K"  IOT_Gateway
 SG_ TCellBattEgyHi_7_4 : 48|16@1+ (0.0078125,0) [0|511.9921875] "°K"  IOT_Gateway
 SG_ TCellBattEgyHi_7_3 : 32|16@1+ (0.0078125,0) [0|511.9921875] "°K"  IOT_Gateway
 SG_ TCellBattEgyHi_7_2 : 16|16@1+ (0.0078125,0) [0|511.9921875] "°K"  IOT_Gateway
 SG_ TCellBattEgyHi_7_1 : 0|16@1+ (0.0078125,0) [0|511.9921875] "°K"  IOT_Gateway

BO_ 101 TCellBattEgyHi_6: 12 BMC
 SG_ TCellBattEgyHi_6_6 : 80|16@1+ (0.0078125,0) [0|511.9921875] "°K"  IOT_Gateway
 SG_ TCellBattEgyHi_6_5 : 64|16@1+ (0.0078125,0) [0|511.9921875] "°K"  IOT_Gateway
 SG_ TCellBattEgyHi_6_4 : 48|16@1+ (0.0078125,0) [0|511.9921875] "°K"  IOT_Gateway
 SG_ TCellBattEgyHi_6_3 : 32|16@1+ (0.0078125,0) [0|511.9921875] "°K"  IOT_Gateway
 SG_ TCellBattEgyHi_6_2 : 16|16@1+ (0.0078125,0) [0|511.9921875] "°K"  IOT_Gateway
 SG_ TCellBattEgyHi_6_1 : 0|16@1+ (0.0078125,0) [0|511.9921875] "°K"  IOT_Gateway

BO_ 100 TCellBattEgyHi_5: 12 BMC
 SG_ TCellBattEgyHi_5_6 : 80|16@1+ (0.0078125,0) [0|511.9921875] "°K"  IOT_Gateway
 SG_ TCellBattEgyHi_5_5 : 64|16@1+ (0.0078125,0) [0|511.9921875] "°K"  IOT_Gateway
 SG_ TCellBattEgyHi_5_4 : 48|16@1+ (0.0078125,0) [0|511.9921875] "°K"  IOT_Gateway
 SG_ TCellBattEgyHi_5_3 : 32|16@1+ (0.0078125,0) [0|511.9921875] "°K"  IOT_Gateway
 SG_ TCellBattEgyHi_5_2 : 16|16@1+ (0.0078125,0) [0|511.9921875] "°K"  IOT_Gateway
 SG_ TCellBattEgyHi_5_1 : 0|16@1+ (0.0078125,0) [0|511.9921875] "°K"  IOT_Gateway

BO_ 99 TCellBattEgyHi_4: 12 BMC
 SG_ TCellBattEgyHi_4_6 : 80|16@1+ (0.0078125,0) [0|511.9921875] "°K"  IOT_Gateway
 SG_ TCellBattEgyHi_4_5 : 64|16@1+ (0.0078125,0) [0|511.9921875] "°K"  IOT_Gateway
 SG_ TCellBattEgyHi_4_4 : 48|16@1+ (0.0078125,0) [0|511.9921875] "°K"  IOT_Gateway
 SG_ TCellBattEgyHi_4_3 : 32|16@1+ (0.0078125,0) [0|511.9921875] "°K"  IOT_Gateway
 SG_ TCellBattEgyHi_4_2 : 16|16@1+ (0.0078125,0) [0|511.9921875] "°K"  IOT_Gateway
 SG_ TCellBattEgyHi_4_1 : 0|16@1+ (0.0078125,0) [0|511.9921875] "°K"  IOT_Gateway

BO_ 98 TCellBattEgyHi_3: 12 BMC
 SG_ TCellBattEgyHi_3_6 : 80|16@1+ (0.0078125,0) [0|511.9921875] "°K"  IOT_Gateway
 SG_ TCellBattEgyHi_3_5 : 64|16@1+ (0.0078125,0) [0|511.9921875] "°K"  IOT_Gateway
 SG_ TCellBattEgyHi_3_4 : 48|16@1+ (0.0078125,0) [0|511.9921875] "°K"  IOT_Gateway
 SG_ TCellBattEgyHi_3_3 : 32|16@1+ (0.0078125,0) [0|511.9921875] "°K"  IOT_Gateway
 SG_ TCellBattEgyHi_3_2 : 16|16@1+ (0.0078125,0) [0|511.9921875] "°K"  IOT_Gateway
 SG_ TCellBattEgyHi_3_1 : 0|16@1+ (0.0078125,0) [0|511.9921875] "°K"  IOT_Gateway

BO_ 97 TCellBattEgyHi_2: 12 BMC
 SG_ TCellBattEgyHi_2_6 : 80|16@1+ (0.0078125,0) [0|511.9921875] "°K"  IOT_Gateway
 SG_ TCellBattEgyHi_2_5 : 64|16@1+ (0.0078125,0) [0|511.9921875] "°K"  IOT_Gateway
 SG_ TCellBattEgyHi_2_4 : 48|16@1+ (0.0078125,0) [0|511.9921875] "°K"  IOT_Gateway
 SG_ TCellBattEgyHi_2_3 : 32|16@1+ (0.0078125,0) [0|511.9921875] "°K"  IOT_Gateway
 SG_ TCellBattEgyHi_2_2 : 16|16@1+ (0.0078125,0) [0|511.9921875] "°K"  IOT_Gateway
 SG_ TCellBattEgyHi_2_1 : 0|16@1+ (0.0078125,0) [0|511.9921875] "°K"  IOT_Gateway

BO_ 96 TCellBattEgyHi_1: 12 BMC
 SG_ TCellBattEgyHi_1_6 : 80|16@1+ (0.0078125,0) [0|511.9921875] "°K"  IOT_Gateway
 SG_ TCellBattEgyHi_1_5 : 64|16@1+ (0.0078125,0) [0|511.9921875] "°K"  IOT_Gateway
 SG_ TCellBattEgyHi_1_4 : 48|16@1+ (0.0078125,0) [0|511.9921875] "°K"  IOT_Gateway
 SG_ TCellBattEgyHi_1_3 : 32|16@1+ (0.0078125,0) [0|511.9921875] "°K"  IOT_Gateway
 SG_ TCellBattEgyHi_1_2 : 16|16@1+ (0.0078125,0) [0|511.9921875] "°K"  IOT_Gateway
 SG_ TCellBattEgyHi_1_1 : 0|16@1+ (0.0078125,0) [0|511.9921875] "°K"  IOT_Gateway

BO_ 91 TCellBattPwrHi_12: 12 BMC
 SG_ TCellBattPwrHi_12_6 : 80|16@1+ (0.0078125,0) [0|511.9921875] "°K" Vector__XXX
 SG_ TCellBattPwrHi_12_5 : 64|16@1+ (0.0078125,0) [0|511.9921875] "°K" Vector__XXX
 SG_ TCellBattPwrHi_12_4 : 48|16@1+ (0.0078125,0) [0|511.9921875] "°K" Vector__XXX
 SG_ TCellBattPwrHi_12_3 : 32|16@1+ (0.0078125,0) [0|511.9921875] "°K" Vector__XXX
 SG_ TCellBattPwrHi_12_2 : 16|16@1+ (0.0078125,0) [0|511.9921875] "°K" Vector__XXX
 SG_ TCellBattPwrHi_12_1 : 0|16@1+ (0.0078125,0) [0|511.9921875] "°K" Vector__XXX

BO_ 90 TCellBattPwrHi_11: 12 BMC
 SG_ TCellBattPwrHi_11_6 : 80|16@1+ (0.0078125,0) [0|511.9921875] "°K" Vector__XXX
 SG_ TCellBattPwrHi_11_5 : 64|16@1+ (0.0078125,0) [0|511.9921875] "°K" Vector__XXX
 SG_ TCellBattPwrHi_11_4 : 48|16@1+ (0.0078125,0) [0|511.9921875] "°K" Vector__XXX
 SG_ TCellBattPwrHi_11_3 : 32|16@1+ (0.0078125,0) [0|511.9921875] "°K" Vector__XXX
 SG_ TCellBattPwrHi_11_2 : 16|16@1+ (0.0078125,0) [0|511.9921875] "°K" Vector__XXX
 SG_ TCellBattPwrHi_11_1 : 0|16@1+ (0.0078125,0) [0|511.9921875] "°K" Vector__XXX

BO_ 89 TCellBattPwrHi_10: 12 BMC
 SG_ TCellBattPwrHi_10_6 : 80|16@1+ (0.0078125,0) [0|511.9921875] "°K" Vector__XXX
 SG_ TCellBattPwrHi_10_5 : 64|16@1+ (0.0078125,0) [0|511.9921875] "°K" Vector__XXX
 SG_ TCellBattPwrHi_10_4 : 48|16@1+ (0.0078125,0) [0|511.9921875] "°K" Vector__XXX
 SG_ TCellBattPwrHi_10_3 : 32|16@1+ (0.0078125,0) [0|511.9921875] "°K" Vector__XXX
 SG_ TCellBattPwrHi_10_2 : 16|16@1+ (0.0078125,0) [0|511.9921875] "°K" Vector__XXX
 SG_ TCellBattPwrHi_10_1 : 0|16@1+ (0.0078125,0) [0|511.9921875] "°K" Vector__XXX

BO_ 88 TCellBattPwrHi_9: 12 BMC
 SG_ TCellBattPwrHi_9_6 : 80|16@1+ (0.0078125,0) [0|511.9921875] "°K" Vector__XXX
 SG_ TCellBattPwrHi_9_5 : 64|16@1+ (0.0078125,0) [0|511.9921875] "°K" Vector__XXX
 SG_ TCellBattPwrHi_9_4 : 48|16@1+ (0.0078125,0) [0|511.9921875] "°K" Vector__XXX
 SG_ TCellBattPwrHi_9_3 : 32|16@1+ (0.0078125,0) [0|511.9921875] "°K" Vector__XXX
 SG_ TCellBattPwrHi_9_2 : 16|16@1+ (0.0078125,0) [0|511.9921875] "°K" Vector__XXX
 SG_ TCellBattPwrHi_9_1 : 0|16@1+ (0.0078125,0) [0|511.9921875] "°K" Vector__XXX

BO_ 87 TCellBattPwrHi_8: 12 BMC
 SG_ TCellBattPwrHi_8_6 : 80|16@1+ (0.0078125,0) [0|511.9921875] "°K" Vector__XXX
 SG_ TCellBattPwrHi_8_5 : 64|16@1+ (0.0078125,0) [0|511.9921875] "°K" Vector__XXX
 SG_ TCellBattPwrHi_8_4 : 48|16@1+ (0.0078125,0) [0|511.9921875] "°K" Vector__XXX
 SG_ TCellBattPwrHi_8_3 : 32|16@1+ (0.0078125,0) [0|511.9921875] "°K" Vector__XXX
 SG_ TCellBattPwrHi_8_2 : 16|16@1+ (0.0078125,0) [0|511.9921875] "°K" Vector__XXX
 SG_ TCellBattPwrHi_8_1 : 0|16@1+ (0.0078125,0) [0|511.9921875] "°K" Vector__XXX

BO_ 86 TCellBattPwrHi_7: 12 BMC
 SG_ TCellBattPwrHi_7_6 : 80|16@1+ (0.0078125,0) [0|511.9921875] "°K" Vector__XXX
 SG_ TCellBattPwrHi_7_5 : 64|16@1+ (0.0078125,0) [0|511.9921875] "°K" Vector__XXX
 SG_ TCellBattPwrHi_7_4 : 48|16@1+ (0.0078125,0) [0|511.9921875] "°K" Vector__XXX
 SG_ TCellBattPwrHi_7_3 : 32|16@1+ (0.0078125,0) [0|511.9921875] "°K" Vector__XXX
 SG_ TCellBattPwrHi_7_2 : 16|16@1+ (0.0078125,0) [0|511.9921875] "°K" Vector__XXX
 SG_ TCellBattPwrHi_7_1 : 0|16@1+ (0.0078125,0) [0|511.9921875] "°K" Vector__XXX

BO_ 85 TCellBattPwrHi_6: 12 BMC
 SG_ TCellBattPwrHi_6_6 : 80|16@1+ (0.0078125,0) [0|511.9921875] "°K" Vector__XXX
 SG_ TCellBattPwrHi_6_5 : 64|16@1+ (0.0078125,0) [0|511.9921875] "°K" Vector__XXX
 SG_ TCellBattPwrHi_6_4 : 48|16@1+ (0.0078125,0) [0|511.9921875] "°K" Vector__XXX
 SG_ TCellBattPwrHi_6_3 : 32|16@1+ (0.0078125,0) [0|511.9921875] "°K" Vector__XXX
 SG_ TCellBattPwrHi_6_2 : 16|16@1+ (0.0078125,0) [0|511.9921875] "°K" Vector__XXX
 SG_ TCellBattPwrHi_6_1 : 0|16@1+ (0.0078125,0) [0|511.9921875] "°K" Vector__XXX

BO_ 84 TCellBattPwrHi_5: 12 BMC
 SG_ TCellBattPwrHi_5_6 : 80|16@1+ (0.0078125,0) [0|511.9921875] "°K" Vector__XXX
 SG_ TCellBattPwrHi_5_5 : 64|16@1+ (0.0078125,0) [0|511.9921875] "°K" Vector__XXX
 SG_ TCellBattPwrHi_5_4 : 48|16@1+ (0.0078125,0) [0|511.9921875] "°K" Vector__XXX
 SG_ TCellBattPwrHi_5_3 : 32|16@1+ (0.0078125,0) [0|511.9921875] "°K" Vector__XXX
 SG_ TCellBattPwrHi_5_2 : 16|16@1+ (0.0078125,0) [0|511.9921875] "°K" Vector__XXX
 SG_ TCellBattPwrHi_5_1 : 0|16@1+ (0.0078125,0) [0|511.9921875] "°K" Vector__XXX

BO_ 83 TCellBattPwrHi_4: 12 BMC
 SG_ TCellBattPwrHi_4_6 : 80|16@1+ (0.0078125,0) [0|511.9921875] "°K" Vector__XXX
 SG_ TCellBattPwrHi_4_5 : 64|16@1+ (0.0078125,0) [0|511.9921875] "°K" Vector__XXX
 SG_ TCellBattPwrHi_4_4 : 48|16@1+ (0.0078125,0) [0|511.9921875] "°K" Vector__XXX
 SG_ TCellBattPwrHi_4_3 : 32|16@1+ (0.0078125,0) [0|511.9921875] "°K" Vector__XXX
 SG_ TCellBattPwrHi_4_2 : 16|16@1+ (0.0078125,0) [0|511.9921875] "°K" Vector__XXX
 SG_ TCellBattPwrHi_4_1 : 0|16@1+ (0.0078125,0) [0|511.9921875] "°K" Vector__XXX

BO_ 82 TCellBattPwrHi_3: 12 BMC
 SG_ TCellBattPwrHi_3_6 : 80|16@1+ (0.0078125,0) [0|511.9921875] "°K" Vector__XXX
 SG_ TCellBattPwrHi_3_5 : 64|16@1+ (0.0078125,0) [0|511.9921875] "°K" Vector__XXX
 SG_ TCellBattPwrHi_3_4 : 48|16@1+ (0.0078125,0) [0|511.9921875] "°K" Vector__XXX
 SG_ TCellBattPwrHi_3_3 : 32|16@1+ (0.0078125,0) [0|511.9921875] "°K" Vector__XXX
 SG_ TCellBattPwrHi_3_2 : 16|16@1+ (0.0078125,0) [0|511.9921875] "°K" Vector__XXX
 SG_ TCellBattPwrHi_3_1 : 0|16@1+ (0.0078125,0) [0|511.9921875] "°K" Vector__XXX

BO_ 81 TCellBattPwrHi_2: 12 BMC
 SG_ TCellBattPwrHi_2_6 : 80|16@1+ (0.0078125,0) [0|511.9921875] "°K" Vector__XXX
 SG_ TCellBattPwrHi_2_5 : 64|16@1+ (0.0078125,0) [0|511.9921875] "°K" Vector__XXX
 SG_ TCellBattPwrHi_2_4 : 48|16@1+ (0.0078125,0) [0|511.9921875] "°K" Vector__XXX
 SG_ TCellBattPwrHi_2_3 : 32|16@1+ (0.0078125,0) [0|511.9921875] "°K" Vector__XXX
 SG_ TCellBattPwrHi_2_2 : 16|16@1+ (0.0078125,0) [0|511.9921875] "°K" Vector__XXX
 SG_ TCellBattPwrHi_2_1 : 0|16@1+ (0.0078125,0) [0|511.9921875] "°K" Vector__XXX

BO_ 80 TCellBattPwrHi_1: 12 BMC
 SG_ TCellBattPwrHi_1_6 : 80|16@1+ (0.0078125,0) [0|511.9921875] "°K"  IOT_Gateway
 SG_ TCellBattPwrHi_1_5 : 64|16@1+ (0.0078125,0) [0|511.9921875] "°K"  IOT_Gateway
 SG_ TCellBattPwrHi_1_4 : 48|16@1+ (0.0078125,0) [0|511.9921875] "°K"  IOT_Gateway
 SG_ TCellBattPwrHi_1_3 : 32|16@1+ (0.0078125,0) [0|511.9921875] "°K"  IOT_Gateway
 SG_ TCellBattPwrHi_1_2 : 16|16@1+ (0.0078125,0) [0|511.9921875] "°K"  IOT_Gateway
 SG_ TCellBattPwrHi_1_1 : 0|16@1+ (0.0078125,0) [0|511.9921875] "°K"  IOT_Gateway

BO_ 79 UCellBattEgyHi_32: 16 BMC
 SG_ UCellBattEgyHi_16_16 : 112|16@1+ (0.00048828125,-16) [-16|15.99951171875] "V"  IOT_Gateway
 SG_ UCellBattEgyHi_16_15 : 96|16@1+ (0.00048828125,-16) [-16|15.99951171875] "V"  IOT_Gateway
 SG_ UCellBattEgyHi_16_14 : 80|16@1+ (0.00048828125,-16) [-16|15.99951171875] "V"  IOT_Gateway
 SG_ UCellBattEgyHi_16_13 : 64|16@1+ (0.00048828125,-16) [-16|15.99951171875] "V"  IOT_Gateway
 SG_ UCellBattEgyHi_16_12 : 48|16@1+ (0.00048828125,-16) [-16|15.99951171875] "V"  IOT_Gateway
 SG_ UCellBattEgyHi_16_11 : 32|16@1+ (0.00048828125,-16) [-16|15.99951171875] "V"  IOT_Gateway
 SG_ UCellBattEgyHi_16_10 : 16|16@1+ (0.00048828125,-16) [-16|15.99951171875] "V"  IOT_Gateway
 SG_ UCellBattEgyHi_16_9 : 0|16@1+ (0.00048828125,-16) [-16|15.99951171875] "V"  IOT_Gateway

BO_ 78 UCellBattEgyHi_31: 16 BMC
 SG_ UCellBattEgyHi_16_8 : 112|16@1+ (0.00048828125,-16) [-16|15.99951171875] "V"  IOT_Gateway
 SG_ UCellBattEgyHi_16_7 : 96|16@1+ (0.00048828125,-16) [-16|15.99951171875] "V"  IOT_Gateway
 SG_ UCellBattEgyHi_16_6 : 80|16@1+ (0.00048828125,-16) [-16|15.99951171875] "V"  IOT_Gateway
 SG_ UCellBattEgyHi_16_5 : 64|16@1+ (0.00048828125,-16) [-16|15.99951171875] "V"  IOT_Gateway
 SG_ UCellBattEgyHi_16_4 : 48|16@1+ (0.00048828125,-16) [-16|15.99951171875] "V"  IOT_Gateway
 SG_ UCellBattEgyHi_16_3 : 32|16@1+ (0.00048828125,-16) [-16|15.99951171875] "V"  IOT_Gateway
 SG_ UCellBattEgyHi_16_2 : 16|16@1+ (0.00048828125,-16) [-16|15.99951171875] "V"  IOT_Gateway
 SG_ UCellBattEgyHi_16_1 : 0|16@1+ (0.00048828125,-16) [-16|15.99951171875] "V"  IOT_Gateway

BO_ 77 UCellBattEgyHi_30: 16 BMC
 SG_ UCellBattEgyHi_15_16 : 112|16@1+ (0.00048828125,-16) [-16|15.99951171875] "V"  IOT_Gateway
 SG_ UCellBattEgyHi_15_15 : 96|16@1+ (0.00048828125,-16) [-16|15.99951171875] "V"  IOT_Gateway
 SG_ UCellBattEgyHi_15_14 : 80|16@1+ (0.00048828125,-16) [-16|15.99951171875] "V"  IOT_Gateway
 SG_ UCellBattEgyHi_15_13 : 64|16@1+ (0.00048828125,-16) [-16|15.99951171875] "V"  IOT_Gateway
 SG_ UCellBattEgyHi_15_12 : 48|16@1+ (0.00048828125,-16) [-16|15.99951171875] "V"  IOT_Gateway
 SG_ UCellBattEgyHi_15_11 : 32|16@1+ (0.00048828125,-16) [-16|15.99951171875] "V"  IOT_Gateway
 SG_ UCellBattEgyHi_15_10 : 16|16@1+ (0.00048828125,-16) [-16|15.99951171875] "V"  IOT_Gateway
 SG_ UCellBattEgyHi_15_9 : 0|16@1+ (0.00048828125,-16) [-16|15.99951171875] "V"  IOT_Gateway

BO_ 76 UCellBattEgyHi_29: 16 BMC
 SG_ UCellBattEgyHi_15_8 : 112|16@1+ (0.00048828125,-16) [-16|15.99951171875] "V"  IOT_Gateway
 SG_ UCellBattEgyHi_15_7 : 96|16@1+ (0.00048828125,-16) [-16|15.99951171875] "V"  IOT_Gateway
 SG_ UCellBattEgyHi_15_6 : 80|16@1+ (0.00048828125,-16) [-16|15.99951171875] "V"  IOT_Gateway
 SG_ UCellBattEgyHi_15_5 : 64|16@1+ (0.00048828125,-16) [-16|15.99951171875] "V"  IOT_Gateway
 SG_ UCellBattEgyHi_15_4 : 48|16@1+ (0.00048828125,-16) [-16|15.99951171875] "V"  IOT_Gateway
 SG_ UCellBattEgyHi_15_3 : 32|16@1+ (0.00048828125,-16) [-16|15.99951171875] "V"  IOT_Gateway
 SG_ UCellBattEgyHi_15_2 : 16|16@1+ (0.00048828125,-16) [-16|15.99951171875] "V"  IOT_Gateway
 SG_ UCellBattEgyHi_15_1 : 0|16@1+ (0.00048828125,-16) [-16|15.99951171875] "V"  IOT_Gateway

BO_ 75 UCellBattEgyHi_28: 16 BMC
 SG_ UCellBattEgyHi_14_16 : 112|16@1+ (0.00048828125,-16) [-16|15.99951171875] "V"  IOT_Gateway
 SG_ UCellBattEgyHi_14_15 : 96|16@1+ (0.00048828125,-16) [-16|15.99951171875] "V"  IOT_Gateway
 SG_ UCellBattEgyHi_14_14 : 80|16@1+ (0.00048828125,-16) [-16|15.99951171875] "V"  IOT_Gateway
 SG_ UCellBattEgyHi_14_13 : 64|16@1+ (0.00048828125,-16) [-16|15.99951171875] "V"  IOT_Gateway
 SG_ UCellBattEgyHi_14_12 : 48|16@1+ (0.00048828125,-16) [-16|15.99951171875] "V"  IOT_Gateway
 SG_ UCellBattEgyHi_14_11 : 32|16@1+ (0.00048828125,-16) [-16|15.99951171875] "V"  IOT_Gateway
 SG_ UCellBattEgyHi_14_10 : 16|16@1+ (0.00048828125,-16) [-16|15.99951171875] "V"  IOT_Gateway
 SG_ UCellBattEgyHi_14_9 : 0|16@1+ (0.00048828125,-16) [-16|15.99951171875] "V"  IOT_Gateway

BO_ 74 UCellBattEgyHi_27: 16 BMC
 SG_ UCellBattEgyHi_14_8 : 112|16@1+ (0.00048828125,-16) [-16|15.99951171875] "V"  IOT_Gateway
 SG_ UCellBattEgyHi_14_7 : 96|16@1+ (0.00048828125,-16) [-16|15.99951171875] "V"  IOT_Gateway
 SG_ UCellBattEgyHi_14_6 : 80|16@1+ (0.00048828125,-16) [-16|15.99951171875] "V"  IOT_Gateway
 SG_ UCellBattEgyHi_14_5 : 64|16@1+ (0.00048828125,-16) [-16|15.99951171875] "V"  IOT_Gateway
 SG_ UCellBattEgyHi_14_4 : 48|16@1+ (0.00048828125,-16) [-16|15.99951171875] "V"  IOT_Gateway
 SG_ UCellBattEgyHi_14_3 : 32|16@1+ (0.00048828125,-16) [-16|15.99951171875] "V"  IOT_Gateway
 SG_ UCellBattEgyHi_14_2 : 16|16@1+ (0.00048828125,-16) [-16|15.99951171875] "V"  IOT_Gateway
 SG_ UCellBattEgyHi_14_1 : 0|16@1+ (0.00048828125,-16) [-16|15.99951171875] "V"  IOT_Gateway

BO_ 73 UCellBattEgyHi_26: 16 BMC
 SG_ UCellBattEgyHi_13_16 : 112|16@1+ (0.00048828125,-16) [-16|15.99951171875] "V"  IOT_Gateway
 SG_ UCellBattEgyHi_13_15 : 96|16@1+ (0.00048828125,-16) [-16|15.99951171875] "V"  IOT_Gateway
 SG_ UCellBattEgyHi_13_14 : 80|16@1+ (0.00048828125,-16) [-16|15.99951171875] "V"  IOT_Gateway
 SG_ UCellBattEgyHi_13_13 : 64|16@1+ (0.00048828125,-16) [-16|15.99951171875] "V"  IOT_Gateway
 SG_ UCellBattEgyHi_13_12 : 48|16@1+ (0.00048828125,-16) [-16|15.99951171875] "V"  IOT_Gateway
 SG_ UCellBattEgyHi_13_11 : 32|16@1+ (0.00048828125,-16) [-16|15.99951171875] "V"  IOT_Gateway
 SG_ UCellBattEgyHi_13_10 : 16|16@1+ (0.00048828125,-16) [-16|15.99951171875] "V"  IOT_Gateway
 SG_ UCellBattEgyHi_13_9 : 0|16@1+ (0.00048828125,-16) [-16|15.99951171875] "V"  IOT_Gateway

BO_ 72 UCellBattEgyHi_25: 16 BMC
 SG_ UCellBattEgyHi_13_8 : 112|16@1+ (0.00048828125,-16) [-16|15.99951171875] "V"  IOT_Gateway
 SG_ UCellBattEgyHi_13_7 : 96|16@1+ (0.00048828125,-16) [-16|15.99951171875] "V"  IOT_Gateway
 SG_ UCellBattEgyHi_13_6 : 80|16@1+ (0.00048828125,-16) [-16|15.99951171875] "V"  IOT_Gateway
 SG_ UCellBattEgyHi_13_5 : 64|16@1+ (0.00048828125,-16) [-16|15.99951171875] "V"  IOT_Gateway
 SG_ UCellBattEgyHi_13_4 : 48|16@1+ (0.00048828125,-16) [-16|15.99951171875] "V"  IOT_Gateway
 SG_ UCellBattEgyHi_13_3 : 32|16@1+ (0.00048828125,-16) [-16|15.99951171875] "V"  IOT_Gateway
 SG_ UCellBattEgyHi_13_2 : 16|16@1+ (0.00048828125,-16) [-16|15.99951171875] "V"  IOT_Gateway
 SG_ UCellBattEgyHi_13_1 : 0|16@1+ (0.00048828125,-16) [-16|15.99951171875] "V"  IOT_Gateway

BO_ 71 UCellBattEgyHi_24: 16 BMC
 SG_ UCellBattEgyHi_12_16 : 112|16@1+ (0.00048828125,-16) [-16|15.99951171875] "V"  IOT_Gateway
 SG_ UCellBattEgyHi_12_15 : 96|16@1+ (0.00048828125,-16) [-16|15.99951171875] "V"  IOT_Gateway
 SG_ UCellBattEgyHi_12_14 : 80|16@1+ (0.00048828125,-16) [-16|15.99951171875] "V"  IOT_Gateway
 SG_ UCellBattEgyHi_12_13 : 64|16@1+ (0.00048828125,-16) [-16|15.99951171875] "V"  IOT_Gateway
 SG_ UCellBattEgyHi_12_12 : 48|16@1+ (0.00048828125,-16) [-16|15.99951171875] "V"  IOT_Gateway
 SG_ UCellBattEgyHi_12_11 : 32|16@1+ (0.00048828125,-16) [-16|15.99951171875] "V"  IOT_Gateway
 SG_ UCellBattEgyHi_12_10 : 16|16@1+ (0.00048828125,-16) [-16|15.99951171875] "V"  IOT_Gateway
 SG_ UCellBattEgyHi_12_9 : 0|16@1+ (0.00048828125,-16) [-16|15.99951171875] "V"  IOT_Gateway

BO_ 70 UCellBattEgyHi_23: 16 BMC
 SG_ UCellBattEgyHi_12_8 : 112|16@1+ (0.00048828125,-16) [-16|15.99951171875] "V"  IOT_Gateway
 SG_ UCellBattEgyHi_12_7 : 96|16@1+ (0.00048828125,-16) [-16|15.99951171875] "V"  IOT_Gateway
 SG_ UCellBattEgyHi_12_6 : 80|16@1+ (0.00048828125,-16) [-16|15.99951171875] "V"  IOT_Gateway
 SG_ UCellBattEgyHi_12_5 : 64|16@1+ (0.00048828125,-16) [-16|15.99951171875] "V"  IOT_Gateway
 SG_ UCellBattEgyHi_12_4 : 48|16@1+ (0.00048828125,-16) [-16|15.99951171875] "V"  IOT_Gateway
 SG_ UCellBattEgyHi_12_3 : 32|16@1+ (0.00048828125,-16) [-16|15.99951171875] "V"  IOT_Gateway
 SG_ UCellBattEgyHi_12_2 : 16|16@1+ (0.00048828125,-16) [-16|15.99951171875] "V"  IOT_Gateway
 SG_ UCellBattEgyHi_12_1 : 0|16@1+ (0.00048828125,-16) [-16|15.99951171875] "V"  IOT_Gateway

BO_ 69 UCellBattEgyHi_22: 16 BMC
 SG_ UCellBattEgyHi_11_16 : 112|16@1+ (0.00048828125,-16) [-16|15.99951171875] "V"  IOT_Gateway
 SG_ UCellBattEgyHi_11_15 : 96|16@1+ (0.00048828125,-16) [-16|15.99951171875] "V"  IOT_Gateway
 SG_ UCellBattEgyHi_11_14 : 80|16@1+ (0.00048828125,-16) [-16|15.99951171875] "V"  IOT_Gateway
 SG_ UCellBattEgyHi_11_13 : 64|16@1+ (0.00048828125,-16) [-16|15.99951171875] "V"  IOT_Gateway
 SG_ UCellBattEgyHi_11_12 : 48|16@1+ (0.00048828125,-16) [-16|15.99951171875] "V"  IOT_Gateway
 SG_ UCellBattEgyHi_11_11 : 32|16@1+ (0.00048828125,-16) [-16|15.99951171875] "V"  IOT_Gateway
 SG_ UCellBattEgyHi_11_10 : 16|16@1+ (0.00048828125,-16) [-16|15.99951171875] "V"  IOT_Gateway
 SG_ UCellBattEgyHi_11_9 : 0|16@1+ (0.00048828125,-16) [-16|15.99951171875] "V"  IOT_Gateway

BO_ 68 UCellBattEgyHi_21: 16 BMC
 SG_ UCellBattEgyHi_11_8 : 112|16@1+ (0.00048828125,-16) [-16|15.99951171875] "V"  IOT_Gateway
 SG_ UCellBattEgyHi_11_7 : 96|16@1+ (0.00048828125,-16) [-16|15.99951171875] "V"  IOT_Gateway
 SG_ UCellBattEgyHi_11_6 : 80|16@1+ (0.00048828125,-16) [-16|15.99951171875] "V"  IOT_Gateway
 SG_ UCellBattEgyHi_11_5 : 64|16@1+ (0.00048828125,-16) [-16|15.99951171875] "V"  IOT_Gateway
 SG_ UCellBattEgyHi_11_4 : 48|16@1+ (0.00048828125,-16) [-16|15.99951171875] "V"  IOT_Gateway
 SG_ UCellBattEgyHi_11_3 : 32|16@1+ (0.00048828125,-16) [-16|15.99951171875] "V"  IOT_Gateway
 SG_ UCellBattEgyHi_11_2 : 16|16@1+ (0.00048828125,-16) [-16|15.99951171875] "V"  IOT_Gateway
 SG_ UCellBattEgyHi_11_1 : 0|16@1+ (0.00048828125,-16) [-16|15.99951171875] "V"  IOT_Gateway

BO_ 67 UCellBattEgyHi_20: 16 BMC
 SG_ UCellBattEgyHi_10_16 : 112|16@1+ (0.00048828125,-16) [-16|15.99951171875] "V"  IOT_Gateway
 SG_ UCellBattEgyHi_10_15 : 96|16@1+ (0.00048828125,-16) [-16|15.99951171875] "V"  IOT_Gateway
 SG_ UCellBattEgyHi_10_14 : 80|16@1+ (0.00048828125,-16) [-16|15.99951171875] "V"  IOT_Gateway
 SG_ UCellBattEgyHi_10_13 : 64|16@1+ (0.00048828125,-16) [-16|15.99951171875] "V"  IOT_Gateway
 SG_ UCellBattEgyHi_10_12 : 48|16@1+ (0.00048828125,-16) [-16|15.99951171875] "V"  IOT_Gateway
 SG_ UCellBattEgyHi_10_11 : 32|16@1+ (0.00048828125,-16) [-16|15.99951171875] "V"  IOT_Gateway
 SG_ UCellBattEgyHi_10_10 : 16|16@1+ (0.00048828125,-16) [-16|15.99951171875] "V"  IOT_Gateway
 SG_ UCellBattEgyHi_10_9 : 0|16@1+ (0.00048828125,-16) [-16|15.99951171875] "V"  IOT_Gateway

BO_ 66 UCellBattEgyHi_19: 16 BMC
 SG_ UCellBattEgyHi_10_8 : 112|16@1+ (0.00048828125,-16) [-16|15.99951171875] "V"  IOT_Gateway
 SG_ UCellBattEgyHi_10_7 : 96|16@1+ (0.00048828125,-16) [-16|15.99951171875] "V"  IOT_Gateway
 SG_ UCellBattEgyHi_10_6 : 80|16@1+ (0.00048828125,-16) [-16|15.99951171875] "V"  IOT_Gateway
 SG_ UCellBattEgyHi_10_5 : 64|16@1+ (0.00048828125,-16) [-16|15.99951171875] "V"  IOT_Gateway
 SG_ UCellBattEgyHi_10_4 : 48|16@1+ (0.00048828125,-16) [-16|15.99951171875] "V"  IOT_Gateway
 SG_ UCellBattEgyHi_10_3 : 32|16@1+ (0.00048828125,-16) [-16|15.99951171875] "V"  IOT_Gateway
 SG_ UCellBattEgyHi_10_2 : 16|16@1+ (0.00048828125,-16) [-16|15.99951171875] "V"  IOT_Gateway
 SG_ UCellBattEgyHi_10_1 : 0|16@1+ (0.00048828125,-16) [-16|15.99951171875] "V"  IOT_Gateway

BO_ 65 UCellBattEgyHi_18: 16 BMC
 SG_ UCellBattEgyHi_9_16 : 112|16@1+ (0.00048828125,-16) [-16|15.99951171875] "V"  IOT_Gateway
 SG_ UCellBattEgyHi_9_15 : 96|16@1+ (0.00048828125,-16) [-16|15.99951171875] "V"  IOT_Gateway
 SG_ UCellBattEgyHi_9_14 : 80|16@1+ (0.00048828125,-16) [-16|15.99951171875] "V"  IOT_Gateway
 SG_ UCellBattEgyHi_9_13 : 64|16@1+ (0.00048828125,-16) [-16|15.99951171875] "V"  IOT_Gateway
 SG_ UCellBattEgyHi_9_12 : 48|16@1+ (0.00048828125,-16) [-16|15.99951171875] "V"  IOT_Gateway
 SG_ UCellBattEgyHi_9_11 : 32|16@1+ (0.00048828125,-16) [-16|15.99951171875] "V"  IOT_Gateway
 SG_ UCellBattEgyHi_9_10 : 16|16@1+ (0.00048828125,-16) [-16|15.99951171875] "V"  IOT_Gateway
 SG_ UCellBattEgyHi_9_9 : 0|16@1+ (0.00048828125,-16) [-16|15.99951171875] "V"  IOT_Gateway

BO_ 64 UCellBattEgyHi_17: 16 BMC
 SG_ UCellBattEgyHi_9_8 : 112|16@1+ (0.00048828125,-16) [-16|15.99951171875] "V"  IOT_Gateway
 SG_ UCellBattEgyHi_9_7 : 96|16@1+ (0.00048828125,-16) [-16|15.99951171875] "V"  IOT_Gateway
 SG_ UCellBattEgyHi_9_6 : 80|16@1+ (0.00048828125,-16) [-16|15.99951171875] "V"  IOT_Gateway
 SG_ UCellBattEgyHi_9_5 : 64|16@1+ (0.00048828125,-16) [-16|15.99951171875] "V"  IOT_Gateway
 SG_ UCellBattEgyHi_9_4 : 48|16@1+ (0.00048828125,-16) [-16|15.99951171875] "V"  IOT_Gateway
 SG_ UCellBattEgyHi_9_3 : 32|16@1+ (0.00048828125,-16) [-16|15.99951171875] "V"  IOT_Gateway
 SG_ UCellBattEgyHi_9_2 : 16|16@1+ (0.00048828125,-16) [-16|15.99951171875] "V"  IOT_Gateway
 SG_ UCellBattEgyHi_9_1 : 0|16@1+ (0.00048828125,-16) [-16|15.99951171875] "V"  IOT_Gateway

BO_ 63 UCellBattEgyHi_16: 16 BMC
 SG_ UCellBattEgyHi_8_16 : 112|16@1+ (0.00048828125,-16) [-16|15.99951171875] "V"  IOT_Gateway
 SG_ UCellBattEgyHi_8_15 : 96|16@1+ (0.00048828125,-16) [-16|15.99951171875] "V"  IOT_Gateway
 SG_ UCellBattEgyHi_8_14 : 80|16@1+ (0.00048828125,-16) [-16|15.99951171875] "V"  IOT_Gateway
 SG_ UCellBattEgyHi_8_13 : 64|16@1+ (0.00048828125,-16) [-16|15.99951171875] "V"  IOT_Gateway
 SG_ UCellBattEgyHi_8_12 : 48|16@1+ (0.00048828125,-16) [-16|15.99951171875] "V"  IOT_Gateway
 SG_ UCellBattEgyHi_8_11 : 32|16@1+ (0.00048828125,-16) [-16|15.99951171875] "V"  IOT_Gateway
 SG_ UCellBattEgyHi_8_10 : 16|16@1+ (0.00048828125,-16) [-16|15.99951171875] "V"  IOT_Gateway
 SG_ UCellBattEgyHi_8_9 : 0|16@1+ (0.00048828125,-16) [-16|15.99951171875] "V"  IOT_Gateway

BO_ 62 UCellBattEgyHi_15: 16 BMC
 SG_ UCellBattEgyHi_8_8 : 112|16@1+ (0.00048828125,-16) [-16|15.99951171875] "V"  IOT_Gateway
 SG_ UCellBattEgyHi_8_7 : 96|16@1+ (0.00048828125,-16) [-16|15.99951171875] "V"  IOT_Gateway
 SG_ UCellBattEgyHi_8_6 : 80|16@1+ (0.00048828125,-16) [-16|15.99951171875] "V"  IOT_Gateway
 SG_ UCellBattEgyHi_8_5 : 64|16@1+ (0.00048828125,-16) [-16|15.99951171875] "V"  IOT_Gateway
 SG_ UCellBattEgyHi_8_4 : 48|16@1+ (0.00048828125,-16) [-16|15.99951171875] "V"  IOT_Gateway
 SG_ UCellBattEgyHi_8_3 : 32|16@1+ (0.00048828125,-16) [-16|15.99951171875] "V"  IOT_Gateway
 SG_ UCellBattEgyHi_8_2 : 16|16@1+ (0.00048828125,-16) [-16|15.99951171875] "V"  IOT_Gateway
 SG_ UCellBattEgyHi_8_1 : 0|16@1+ (0.00048828125,-16) [-16|15.99951171875] "V"  IOT_Gateway

BO_ 61 UCellBattEgyHi_14: 16 BMC
 SG_ UCellBattEgyHi_7_16 : 112|16@1+ (0.00048828125,-16) [-16|15.99951171875] "V"  IOT_Gateway
 SG_ UCellBattEgyHi_7_15 : 96|16@1+ (0.00048828125,-16) [-16|15.99951171875] "V"  IOT_Gateway
 SG_ UCellBattEgyHi_7_14 : 80|16@1+ (0.00048828125,-16) [-16|15.99951171875] "V"  IOT_Gateway
 SG_ UCellBattEgyHi_7_13 : 64|16@1+ (0.00048828125,-16) [-16|15.99951171875] "V"  IOT_Gateway
 SG_ UCellBattEgyHi_7_12 : 48|16@1+ (0.00048828125,-16) [-16|15.99951171875] "V"  IOT_Gateway
 SG_ UCellBattEgyHi_7_11 : 32|16@1+ (0.00048828125,-16) [-16|15.99951171875] "V"  IOT_Gateway
 SG_ UCellBattEgyHi_7_10 : 16|16@1+ (0.00048828125,-16) [-16|15.99951171875] "V"  IOT_Gateway
 SG_ UCellBattEgyHi_7_9 : 0|16@1+ (0.00048828125,-16) [-16|15.99951171875] "V"  IOT_Gateway

BO_ 60 UCellBattEgyHi_13: 16 BMC
 SG_ UCellBattEgyHi_7_8 : 112|16@1+ (0.00048828125,-16) [-16|15.99951171875] "V"  IOT_Gateway
 SG_ UCellBattEgyHi_7_7 : 96|16@1+ (0.00048828125,-16) [-16|15.99951171875] "V"  IOT_Gateway
 SG_ UCellBattEgyHi_7_6 : 80|16@1+ (0.00048828125,-16) [-16|15.99951171875] "V"  IOT_Gateway
 SG_ UCellBattEgyHi_7_5 : 64|16@1+ (0.00048828125,-16) [-16|15.99951171875] "V"  IOT_Gateway
 SG_ UCellBattEgyHi_7_4 : 48|16@1+ (0.00048828125,-16) [-16|15.99951171875] "V"  IOT_Gateway
 SG_ UCellBattEgyHi_7_3 : 32|16@1+ (0.00048828125,-16) [-16|15.99951171875] "V"  IOT_Gateway
 SG_ UCellBattEgyHi_7_2 : 16|16@1+ (0.00048828125,-16) [-16|15.99951171875] "V"  IOT_Gateway
 SG_ UCellBattEgyHi_7_1 : 0|16@1+ (0.00048828125,-16) [-16|15.99951171875] "V"  IOT_Gateway

BO_ 59 UCellBattEgyHi_12: 16 BMC
 SG_ UCellBattEgyHi_6_16 : 112|16@1+ (0.00048828125,-16) [-16|15.99951171875] "V"  IOT_Gateway
 SG_ UCellBattEgyHi_6_15 : 96|16@1+ (0.00048828125,-16) [-16|15.99951171875] "V"  IOT_Gateway
 SG_ UCellBattEgyHi_6_14 : 80|16@1+ (0.00048828125,-16) [-16|15.99951171875] "V"  IOT_Gateway
 SG_ UCellBattEgyHi_6_13 : 64|16@1+ (0.00048828125,-16) [-16|15.99951171875] "V"  IOT_Gateway
 SG_ UCellBattEgyHi_6_12 : 48|16@1+ (0.00048828125,-16) [-16|15.99951171875] "V"  IOT_Gateway
 SG_ UCellBattEgyHi_6_11 : 32|16@1+ (0.00048828125,-16) [-16|15.99951171875] "V"  IOT_Gateway
 SG_ UCellBattEgyHi_6_10 : 16|16@1+ (0.00048828125,-16) [-16|15.99951171875] "V"  IOT_Gateway
 SG_ UCellBattEgyHi_6_9 : 0|16@1+ (0.00048828125,-16) [-16|15.99951171875] "V"  IOT_Gateway

BO_ 58 UCellBattEgyHi_11: 16 BMC
 SG_ UCellBattEgyHi_6_8 : 112|16@1+ (0.00048828125,-16) [-16|15.99951171875] "V"  IOT_Gateway
 SG_ UCellBattEgyHi_6_7 : 96|16@1+ (0.00048828125,-16) [-16|15.99951171875] "V"  IOT_Gateway
 SG_ UCellBattEgyHi_6_6 : 80|16@1+ (0.00048828125,-16) [-16|15.99951171875] "V"  IOT_Gateway
 SG_ UCellBattEgyHi_6_5 : 64|16@1+ (0.00048828125,-16) [-16|15.99951171875] "V"  IOT_Gateway
 SG_ UCellBattEgyHi_6_4 : 48|16@1+ (0.00048828125,-16) [-16|15.99951171875] "V"  IOT_Gateway
 SG_ UCellBattEgyHi_6_3 : 32|16@1+ (0.00048828125,-16) [-16|15.99951171875] "V"  IOT_Gateway
 SG_ UCellBattEgyHi_6_2 : 16|16@1+ (0.00048828125,-16) [-16|15.99951171875] "V"  IOT_Gateway
 SG_ UCellBattEgyHi_6_1 : 0|16@1+ (0.00048828125,-16) [-16|15.99951171875] "V"  IOT_Gateway

BO_ 57 UCellBattEgyHi_10: 16 BMC
 SG_ UCellBattEgyHi_5_16 : 112|16@1+ (0.00048828125,-16) [-16|15.99951171875] "V"  IOT_Gateway
 SG_ UCellBattEgyHi_5_15 : 96|16@1+ (0.00048828125,-16) [-16|15.99951171875] "V"  IOT_Gateway
 SG_ UCellBattEgyHi_5_14 : 80|16@1+ (0.00048828125,-16) [-16|15.99951171875] "V"  IOT_Gateway
 SG_ UCellBattEgyHi_5_13 : 64|16@1+ (0.00048828125,-16) [-16|15.99951171875] "V"  IOT_Gateway
 SG_ UCellBattEgyHi_5_12 : 48|16@1+ (0.00048828125,-16) [-16|15.99951171875] "V"  IOT_Gateway
 SG_ UCellBattEgyHi_5_11 : 32|16@1+ (0.00048828125,-16) [-16|15.99951171875] "V"  IOT_Gateway
 SG_ UCellBattEgyHi_5_10 : 16|16@1+ (0.00048828125,-16) [-16|15.99951171875] "V"  IOT_Gateway
 SG_ UCellBattEgyHi_5_9 : 0|16@1+ (0.00048828125,-16) [-16|15.99951171875] "V"  IOT_Gateway

BO_ 56 UCellBattEgyHi_9: 16 BMC
 SG_ UCellBattEgyHi_5_8 : 112|16@1+ (0.00048828125,-16) [-16|15.99951171875] "V"  IOT_Gateway
 SG_ UCellBattEgyHi_5_7 : 96|16@1+ (0.00048828125,-16) [-16|15.99951171875] "V"  IOT_Gateway
 SG_ UCellBattEgyHi_5_6 : 80|16@1+ (0.00048828125,-16) [-16|15.99951171875] "V"  IOT_Gateway
 SG_ UCellBattEgyHi_5_5 : 64|16@1+ (0.00048828125,-16) [-16|15.99951171875] "V"  IOT_Gateway
 SG_ UCellBattEgyHi_5_4 : 48|16@1+ (0.00048828125,-16) [-16|15.99951171875] "V"  IOT_Gateway
 SG_ UCellBattEgyHi_5_3 : 32|16@1+ (0.00048828125,-16) [-16|15.99951171875] "V"  IOT_Gateway
 SG_ UCellBattEgyHi_5_2 : 16|16@1+ (0.00048828125,-16) [-16|15.99951171875] "V"  IOT_Gateway
 SG_ UCellBattEgyHi_5_1 : 0|16@1+ (0.00048828125,-16) [-16|15.99951171875] "V"  IOT_Gateway

BO_ 55 UCellBattEgyHi_8: 16 BMC
 SG_ UCellBattEgyHi_4_16 : 112|16@1+ (0.00048828125,-16) [-16|15.99951171875] "V"  IOT_Gateway
 SG_ UCellBattEgyHi_4_15 : 96|16@1+ (0.00048828125,-16) [-16|15.99951171875] "V"  IOT_Gateway
 SG_ UCellBattEgyHi_4_14 : 80|16@1+ (0.00048828125,-16) [-16|15.99951171875] "V"  IOT_Gateway
 SG_ UCellBattEgyHi_4_13 : 64|16@1+ (0.00048828125,-16) [-16|15.99951171875] "V"  IOT_Gateway
 SG_ UCellBattEgyHi_4_12 : 48|16@1+ (0.00048828125,-16) [-16|15.99951171875] "V"  IOT_Gateway
 SG_ UCellBattEgyHi_4_11 : 32|16@1+ (0.00048828125,-16) [-16|15.99951171875] "V"  IOT_Gateway
 SG_ UCellBattEgyHi_4_10 : 16|16@1+ (0.00048828125,-16) [-16|15.99951171875] "V"  IOT_Gateway
 SG_ UCellBattEgyHi_4_9 : 0|16@1+ (0.00048828125,-16) [-16|15.99951171875] "V"  IOT_Gateway

BO_ 54 UCellBattEgyHi_7: 16 BMC
 SG_ UCellBattEgyHi_4_8 : 112|16@1+ (0.00048828125,-16) [-16|15.99951171875] "V"  IOT_Gateway
 SG_ UCellBattEgyHi_4_7 : 96|16@1+ (0.00048828125,-16) [-16|15.99951171875] "V"  IOT_Gateway
 SG_ UCellBattEgyHi_4_6 : 80|16@1+ (0.00048828125,-16) [-16|15.99951171875] "V"  IOT_Gateway
 SG_ UCellBattEgyHi_4_5 : 64|16@1+ (0.00048828125,-16) [-16|15.99951171875] "V"  IOT_Gateway
 SG_ UCellBattEgyHi_4_4 : 48|16@1+ (0.00048828125,-16) [-16|15.99951171875] "V"  IOT_Gateway
 SG_ UCellBattEgyHi_4_3 : 32|16@1+ (0.00048828125,-16) [-16|15.99951171875] "V"  IOT_Gateway
 SG_ UCellBattEgyHi_4_2 : 16|16@1+ (0.00048828125,-16) [-16|15.99951171875] "V"  IOT_Gateway
 SG_ UCellBattEgyHi_4_1 : 0|16@1+ (0.00048828125,-16) [-16|15.99951171875] "V"  IOT_Gateway

BO_ 53 UCellBattEgyHi_6: 16 BMC
 SG_ UCellBattEgyHi_3_16 : 112|16@1+ (0.00048828125,-16) [-16|15.99951171875] "V"  IOT_Gateway
 SG_ UCellBattEgyHi_3_15 : 96|16@1+ (0.00048828125,-16) [-16|15.99951171875] "V"  IOT_Gateway
 SG_ UCellBattEgyHi_3_14 : 80|16@1+ (0.00048828125,-16) [-16|15.99951171875] "V"  IOT_Gateway
 SG_ UCellBattEgyHi_3_13 : 64|16@1+ (0.00048828125,-16) [-16|15.99951171875] "V"  IOT_Gateway
 SG_ UCellBattEgyHi_3_12 : 48|16@1+ (0.00048828125,-16) [-16|15.99951171875] "V"  IOT_Gateway
 SG_ UCellBattEgyHi_3_11 : 32|16@1+ (0.00048828125,-16) [-16|15.99951171875] "V"  IOT_Gateway
 SG_ UCellBattEgyHi_3_10 : 16|16@1+ (0.00048828125,-16) [-16|15.99951171875] "V"  IOT_Gateway
 SG_ UCellBattEgyHi_3_9 : 0|16@1+ (0.00048828125,-16) [-16|15.99951171875] "V"  IOT_Gateway

BO_ 52 UCellBattEgyHi_5: 16 BMC
 SG_ UCellBattEgyHi_3_8 : 112|16@1+ (0.00048828125,-16) [-16|15.99951171875] "V"  IOT_Gateway
 SG_ UCellBattEgyHi_3_7 : 96|16@1+ (0.00048828125,-16) [-16|15.99951171875] "V"  IOT_Gateway
 SG_ UCellBattEgyHi_3_6 : 80|16@1+ (0.00048828125,-16) [-16|15.99951171875] "V"  IOT_Gateway
 SG_ UCellBattEgyHi_3_5 : 64|16@1+ (0.00048828125,-16) [-16|15.99951171875] "V"  IOT_Gateway
 SG_ UCellBattEgyHi_3_4 : 48|16@1+ (0.00048828125,-16) [-16|15.99951171875] "V"  IOT_Gateway
 SG_ UCellBattEgyHi_3_3 : 32|16@1+ (0.00048828125,-16) [-16|15.99951171875] "V"  IOT_Gateway
 SG_ UCellBattEgyHi_3_2 : 16|16@1+ (0.00048828125,-16) [-16|15.99951171875] "V"  IOT_Gateway
 SG_ UCellBattEgyHi_3_1 : 0|16@1+ (0.00048828125,-16) [-16|15.99951171875] "V"  IOT_Gateway

BO_ 51 UCellBattEgyHi_4: 16 BMC
 SG_ UCellBattEgyHi_2_16 : 112|16@1+ (0.00048828125,-16) [-16|15.99951171875] "V"  IOT_Gateway
 SG_ UCellBattEgyHi_2_15 : 96|16@1+ (0.00048828125,-16) [-16|15.99951171875] "V"  IOT_Gateway
 SG_ UCellBattEgyHi_2_14 : 80|16@1+ (0.00048828125,-16) [-16|15.99951171875] "V"  IOT_Gateway
 SG_ UCellBattEgyHi_2_13 : 64|16@1+ (0.00048828125,-16) [-16|15.99951171875] "V"  IOT_Gateway
 SG_ UCellBattEgyHi_2_12 : 48|16@1+ (0.00048828125,-16) [-16|15.99951171875] "V"  IOT_Gateway
 SG_ UCellBattEgyHi_2_11 : 32|16@1+ (0.00048828125,-16) [-16|15.99951171875] "V"  IOT_Gateway
 SG_ UCellBattEgyHi_2_10 : 16|16@1+ (0.00048828125,-16) [-16|15.99951171875] "V"  IOT_Gateway
 SG_ UCellBattEgyHi_2_9 : 0|16@1+ (0.00048828125,-16) [-16|15.99951171875] "V"  IOT_Gateway

BO_ 50 UCellBattEgyHi_3: 16 BMC
 SG_ UCellBattEgyHi_2_8 : 112|16@1+ (0.00048828125,-16) [-16|15.99951171875] "V"  IOT_Gateway
 SG_ UCellBattEgyHi_2_7 : 96|16@1+ (0.00048828125,-16) [-16|15.99951171875] "V"  IOT_Gateway
 SG_ UCellBattEgyHi_2_6 : 80|16@1+ (0.00048828125,-16) [-16|15.99951171875] "V"  IOT_Gateway
 SG_ UCellBattEgyHi_2_5 : 64|16@1+ (0.00048828125,-16) [-16|15.99951171875] "V"  IOT_Gateway
 SG_ UCellBattEgyHi_2_4 : 48|16@1+ (0.00048828125,-16) [-16|15.99951171875] "V"  IOT_Gateway
 SG_ UCellBattEgyHi_2_3 : 32|16@1+ (0.00048828125,-16) [-16|15.99951171875] "V"  IOT_Gateway
 SG_ UCellBattEgyHi_2_2 : 16|16@1+ (0.00048828125,-16) [-16|15.99951171875] "V"  IOT_Gateway
 SG_ UCellBattEgyHi_2_1 : 0|16@1+ (0.00048828125,-16) [-16|15.99951171875] "V"  IOT_Gateway

BO_ 49 UCellBattEgyHi_2: 16 BMC
 SG_ UCellBattEgyHi_1_9 : 0|16@1+ (0.00048828125,-16) [-16|15.99951171875] "V"  IOT_Gateway
 SG_ UCellBattEgyHi_1_10 : 16|16@1+ (0.00048828125,-16) [-16|15.99951171875] "V"  IOT_Gateway
 SG_ UCellBattEgyHi_1_11 : 32|16@1+ (0.00048828125,-16) [-16|15.99951171875] "V"  IOT_Gateway
 SG_ UCellBattEgyHi_1_12 : 48|16@1+ (0.00048828125,-16) [-16|15.99951171875] "V"  IOT_Gateway
 SG_ UCellBattEgyHi_1_13 : 64|16@1+ (0.00048828125,-16) [-16|15.99951171875] "V"  IOT_Gateway
 SG_ UCellBattEgyHi_1_14 : 80|16@1+ (0.00048828125,-16) [-16|15.99951171875] "V"  IOT_Gateway
 SG_ UCellBattEgyHi_1_15 : 96|16@1+ (0.00048828125,-16) [-16|15.99951171875] "V"  IOT_Gateway
 SG_ UCellBattEgyHi_1_16 : 112|16@1+ (0.00048828125,-16) [-16|15.99951171875] "V"  IOT_Gateway

BO_ 48 UCellBattEgyHi_1: 16 BMC
 SG_ UCellBattEgyHi_1_7 : 96|16@1+ (0.00048828125,-16) [-16|15.99951171875] "V"  IOT_Gateway
 SG_ UCellBattEgyHi_1_8 : 112|16@1+ (0.00048828125,-16) [-16|15.99951171875] "V"  IOT_Gateway
 SG_ UCellBattEgyHi_1_6 : 80|16@1+ (0.00048828125,-16) [-16|15.99951171875] "V"  IOT_Gateway
 SG_ UCellBattEgyHi_1_5 : 64|16@1+ (0.00048828125,-16) [-16|15.99951171875] "V"  IOT_Gateway
 SG_ UCellBattEgyHi_1_4 : 48|16@1+ (0.00048828125,-16) [-16|15.99951171875] "V"  IOT_Gateway
 SG_ UCellBattEgyHi_1_3 : 32|16@1+ (0.00048828125,-16) [-16|15.99951171875] "V"  IOT_Gateway
 SG_ UCellBattEgyHi_1_2 : 16|16@1+ (0.00048828125,-16) [-16|15.99951171875] "V"  IOT_Gateway
 SG_ UCellBattEgyHi_1_1 : 0|16@1+ (0.00048828125,-16) [-16|15.99951171875] "V"  IOT_Gateway

BO_ 47 UCellBattPwrHi_32: 16 BMC
 SG_ UCellBattPwrHi_16_16 : 112|16@1+ (0.00048828125,-16) [-16|15.99951171875] "V"  IOT_Gateway
 SG_ UCellBattPwrHi_16_15 : 96|16@1+ (0.00048828125,-16) [-16|15.99951171875] "V"  IOT_Gateway
 SG_ UCellBattPwrHi_16_14 : 80|16@1+ (0.00048828125,-16) [-16|15.99951171875] "V"  IOT_Gateway
 SG_ UCellBattPwrHi_16_13 : 64|16@1+ (0.00048828125,-16) [-16|15.99951171875] "V"  IOT_Gateway
 SG_ UCellBattPwrHi_16_12 : 48|16@1+ (0.00048828125,-16) [-16|15.99951171875] "V"  IOT_Gateway
 SG_ UCellBattPwrHi_16_11 : 32|16@1+ (0.00048828125,-16) [-16|15.99951171875] "V"  IOT_Gateway
 SG_ UCellBattPwrHi_16_10 : 16|16@1+ (0.00048828125,-16) [-16|15.99951171875] "V"  IOT_Gateway
 SG_ UCellBattPwrHi_16_9 : 0|16@1+ (0.00048828125,-16) [-16|15.99951171875] "V"  IOT_Gateway

BO_ 46 UCellBattPwrHi_31: 16 BMC
 SG_ UCellBattPwrHi_16_8 : 112|16@1+ (0.00048828125,-16) [-16|15.99951171875] "V"  IOT_Gateway
 SG_ UCellBattPwrHi_16_7 : 96|16@1+ (0.00048828125,-16) [-16|15.99951171875] "V"  IOT_Gateway
 SG_ UCellBattPwrHi_16_6 : 80|16@1+ (0.00048828125,-16) [-16|15.99951171875] "V"  IOT_Gateway
 SG_ UCellBattPwrHi_16_5 : 64|16@1+ (0.00048828125,-16) [-16|15.99951171875] "V"  IOT_Gateway
 SG_ UCellBattPwrHi_16_4 : 48|16@1+ (0.00048828125,-16) [-16|15.99951171875] "V"  IOT_Gateway
 SG_ UCellBattPwrHi_16_3 : 32|16@1+ (0.00048828125,-16) [-16|15.99951171875] "V"  IOT_Gateway
 SG_ UCellBattPwrHi_16_2 : 16|16@1+ (0.00048828125,-16) [-16|15.99951171875] "V"  IOT_Gateway
 SG_ UCellBattPwrHi_16_1 : 0|16@1+ (0.00048828125,-16) [-16|15.99951171875] "V"  IOT_Gateway

BO_ 45 UCellBattPwrHi_30: 16 BMC
 SG_ UCellBattPwrHi_15_16 : 112|16@1+ (0.00048828125,-16) [-16|15.99951171875] "V"  IOT_Gateway
 SG_ UCellBattPwrHi_15_15 : 96|16@1+ (0.00048828125,-16) [-16|15.99951171875] "V"  IOT_Gateway
 SG_ UCellBattPwrHi_15_14 : 80|16@1+ (0.00048828125,-16) [-16|15.99951171875] "V"  IOT_Gateway
 SG_ UCellBattPwrHi_15_13 : 64|16@1+ (0.00048828125,-16) [-16|15.99951171875] "V"  IOT_Gateway
 SG_ UCellBattPwrHi_15_12 : 48|16@1+ (0.00048828125,-16) [-16|15.99951171875] "V"  IOT_Gateway
 SG_ UCellBattPwrHi_15_11 : 32|16@1+ (0.00048828125,-16) [-16|15.99951171875] "V"  IOT_Gateway
 SG_ UCellBattPwrHi_15_10 : 16|16@1+ (0.00048828125,-16) [-16|15.99951171875] "V"  IOT_Gateway
 SG_ UCellBattPwrHi_15_9 : 0|16@1+ (0.00048828125,-16) [-16|15.99951171875] "V"  IOT_Gateway

BO_ 44 UCellBattPwrHi_29: 16 BMC
 SG_ UCellBattPwrHi_15_8 : 112|16@1+ (0.00048828125,-16) [-16|15.99951171875] "V"  IOT_Gateway
 SG_ UCellBattPwrHi_15_7 : 96|16@1+ (0.00048828125,-16) [-16|15.99951171875] "V"  IOT_Gateway
 SG_ UCellBattPwrHi_15_6 : 80|16@1+ (0.00048828125,-16) [-16|15.99951171875] "V"  IOT_Gateway
 SG_ UCellBattPwrHi_15_5 : 64|16@1+ (0.00048828125,-16) [-16|15.99951171875] "V"  IOT_Gateway
 SG_ UCellBattPwrHi_15_4 : 48|16@1+ (0.00048828125,-16) [-16|15.99951171875] "V"  IOT_Gateway
 SG_ UCellBattPwrHi_15_3 : 32|16@1+ (0.00048828125,-16) [-16|15.99951171875] "V"  IOT_Gateway
 SG_ UCellBattPwrHi_15_2 : 16|16@1+ (0.00048828125,-16) [-16|15.99951171875] "V"  IOT_Gateway
 SG_ UCellBattPwrHi_15_1 : 0|16@1+ (0.00048828125,-16) [-16|15.99951171875] "V"  IOT_Gateway

BO_ 43 UCellBattPwrHi_28: 16 BMC
 SG_ UCellBattPwrHi_14_16 : 112|16@1+ (0.00048828125,-16) [-16|15.99951171875] "V"  IOT_Gateway
 SG_ UCellBattPwrHi_14_15 : 96|16@1+ (0.00048828125,-16) [-16|15.99951171875] "V"  IOT_Gateway
 SG_ UCellBattPwrHi_14_14 : 80|16@1+ (0.00048828125,-16) [-16|15.99951171875] "V"  IOT_Gateway
 SG_ UCellBattPwrHi_14_13 : 64|16@1+ (0.00048828125,-16) [-16|15.99951171875] "V"  IOT_Gateway
 SG_ UCellBattPwrHi_14_12 : 48|16@1+ (0.00048828125,-16) [-16|15.99951171875] "V"  IOT_Gateway
 SG_ UCellBattPwrHi_14_11 : 32|16@1+ (0.00048828125,-16) [-16|15.99951171875] "V"  IOT_Gateway
 SG_ UCellBattPwrHi_14_10 : 16|16@1+ (0.00048828125,-16) [-16|15.99951171875] "V"  IOT_Gateway
 SG_ UCellBattPwrHi_14_9 : 0|16@1+ (0.00048828125,-16) [-16|15.99951171875] "V"  IOT_Gateway

BO_ 42 UCellBattPwrHi_27: 16 BMC
 SG_ UCellBattPwrHi_14_8 : 112|16@1+ (0.00048828125,-16) [-16|15.99951171875] "V"  IOT_Gateway
 SG_ UCellBattPwrHi_14_7 : 96|16@1+ (0.00048828125,-16) [-16|15.99951171875] "V"  IOT_Gateway
 SG_ UCellBattPwrHi_14_6 : 80|16@1+ (0.00048828125,-16) [-16|15.99951171875] "V"  IOT_Gateway
 SG_ UCellBattPwrHi_14_5 : 64|16@1+ (0.00048828125,-16) [-16|15.99951171875] "V"  IOT_Gateway
 SG_ UCellBattPwrHi_14_4 : 48|16@1+ (0.00048828125,-16) [-16|15.99951171875] "V"  IOT_Gateway
 SG_ UCellBattPwrHi_14_3 : 32|16@1+ (0.00048828125,-16) [-16|15.99951171875] "V"  IOT_Gateway
 SG_ UCellBattPwrHi_14_2 : 16|16@1+ (0.00048828125,-16) [-16|15.99951171875] "V"  IOT_Gateway
 SG_ UCellBattPwrHi_14_1 : 0|16@1+ (0.00048828125,-16) [-16|15.99951171875] "V"  IOT_Gateway

BO_ 41 UCellBattPwrHi_26: 16 BMC
 SG_ UCellBattPwrHi_13_16 : 112|16@1+ (0.00048828125,-16) [-16|15.99951171875] "V"  IOT_Gateway
 SG_ UCellBattPwrHi_13_15 : 96|16@1+ (0.00048828125,-16) [-16|15.99951171875] "V"  IOT_Gateway
 SG_ UCellBattPwrHi_13_14 : 80|16@1+ (0.00048828125,-16) [-16|15.99951171875] "V"  IOT_Gateway
 SG_ UCellBattPwrHi_13_13 : 64|16@1+ (0.00048828125,-16) [-16|15.99951171875] "V"  IOT_Gateway
 SG_ UCellBattPwrHi_13_12 : 48|16@1+ (0.00048828125,-16) [-16|15.99951171875] "V"  IOT_Gateway
 SG_ UCellBattPwrHi_13_11 : 32|16@1+ (0.00048828125,-16) [-16|15.99951171875] "V"  IOT_Gateway
 SG_ UCellBattPwrHi_13_10 : 16|16@1+ (0.00048828125,-16) [-16|15.99951171875] "V"  IOT_Gateway
 SG_ UCellBattPwrHi_13_9 : 0|16@1+ (0.00048828125,-16) [-16|15.99951171875] "V"  IOT_Gateway

BO_ 40 UCellBattPwrHi_25: 16 BMC
 SG_ UCellBattPwrHi_13_8 : 112|16@1+ (0.00048828125,-16) [-16|15.99951171875] "V"  IOT_Gateway
 SG_ UCellBattPwrHi_13_7 : 96|16@1+ (0.00048828125,-16) [-16|15.99951171875] "V"  IOT_Gateway
 SG_ UCellBattPwrHi_13_6 : 80|16@1+ (0.00048828125,-16) [-16|15.99951171875] "V"  IOT_Gateway
 SG_ UCellBattPwrHi_13_5 : 64|16@1+ (0.00048828125,-16) [-16|15.99951171875] "V"  IOT_Gateway
 SG_ UCellBattPwrHi_13_4 : 48|16@1+ (0.00048828125,-16) [-16|15.99951171875] "V"  IOT_Gateway
 SG_ UCellBattPwrHi_13_3 : 32|16@1+ (0.00048828125,-16) [-16|15.99951171875] "V"  IOT_Gateway
 SG_ UCellBattPwrHi_13_2 : 16|16@1+ (0.00048828125,-16) [-16|15.99951171875] "V"  IOT_Gateway
 SG_ UCellBattPwrHi_13_1 : 0|16@1+ (0.00048828125,-16) [-16|15.99951171875] "V"  IOT_Gateway

BO_ 39 UCellBattPwrHi_24: 16 BMC
 SG_ UCellBattPwrHi_12_16 : 112|16@1+ (0.00048828125,-16) [-16|15.99951171875] "V"  IOT_Gateway
 SG_ UCellBattPwrHi_12_15 : 96|16@1+ (0.00048828125,-16) [-16|15.99951171875] "V"  IOT_Gateway
 SG_ UCellBattPwrHi_12_14 : 80|16@1+ (0.00048828125,-16) [-16|15.99951171875] "V"  IOT_Gateway
 SG_ UCellBattPwrHi_12_13 : 64|16@1+ (0.00048828125,-16) [-16|15.99951171875] "V"  IOT_Gateway
 SG_ UCellBattPwrHi_12_12 : 48|16@1+ (0.00048828125,-16) [-16|15.99951171875] "V"  IOT_Gateway
 SG_ UCellBattPwrHi_12_11 : 32|16@1+ (0.00048828125,-16) [-16|15.99951171875] "V"  IOT_Gateway
 SG_ UCellBattPwrHi_12_10 : 16|16@1+ (0.00048828125,-16) [-16|15.99951171875] "V"  IOT_Gateway
 SG_ UCellBattPwrHi_12_9 : 0|16@1+ (0.00048828125,-16) [-16|15.99951171875] "V"  IOT_Gateway

BO_ 38 UCellBattPwrHi_23: 16 BMC
 SG_ UCellBattPwrHi_12_8 : 112|16@1+ (0.00048828125,-16) [-16|15.99951171875] "V"  IOT_Gateway
 SG_ UCellBattPwrHi_12_7 : 96|16@1+ (0.00048828125,-16) [-16|15.99951171875] "V"  IOT_Gateway
 SG_ UCellBattPwrHi_12_6 : 80|16@1+ (0.00048828125,-16) [-16|15.99951171875] "V"  IOT_Gateway
 SG_ UCellBattPwrHi_12_5 : 64|16@1+ (0.00048828125,-16) [-16|15.99951171875] "V"  IOT_Gateway
 SG_ UCellBattPwrHi_12_4 : 48|16@1+ (0.00048828125,-16) [-16|15.99951171875] "V"  IOT_Gateway
 SG_ UCellBattPwrHi_12_3 : 32|16@1+ (0.00048828125,-16) [-16|15.99951171875] "V"  IOT_Gateway
 SG_ UCellBattPwrHi_12_2 : 16|16@1+ (0.00048828125,-16) [-16|15.99951171875] "V"  IOT_Gateway
 SG_ UCellBattPwrHi_12_1 : 0|16@1+ (0.00048828125,-16) [-16|15.99951171875] "V"  IOT_Gateway

BO_ 37 UCellBattPwrHi_22: 16 BMC
 SG_ UCellBattPwrHi_11_16 : 112|16@1+ (0.00048828125,-16) [-16|15.99951171875] "V"  IOT_Gateway
 SG_ UCellBattPwrHi_11_15 : 96|16@1+ (0.00048828125,-16) [-16|15.99951171875] "V"  IOT_Gateway
 SG_ UCellBattPwrHi_11_14 : 80|16@1+ (0.00048828125,-16) [-16|15.99951171875] "V"  IOT_Gateway
 SG_ UCellBattPwrHi_11_13 : 64|16@1+ (0.00048828125,-16) [-16|15.99951171875] "V"  IOT_Gateway
 SG_ UCellBattPwrHi_11_12 : 48|16@1+ (0.00048828125,-16) [-16|15.99951171875] "V"  IOT_Gateway
 SG_ UCellBattPwrHi_11_11 : 32|16@1+ (0.00048828125,-16) [-16|15.99951171875] "V"  IOT_Gateway
 SG_ UCellBattPwrHi_11_10 : 16|16@1+ (0.00048828125,-16) [-16|15.99951171875] "V"  IOT_Gateway
 SG_ UCellBattPwrHi_11_9 : 0|16@1+ (0.00048828125,-16) [-16|15.99951171875] "V"  IOT_Gateway

BO_ 36 UCellBattPwrHi_21: 16 BMC
 SG_ UCellBattPwrHi_11_8 : 112|16@1+ (0.00048828125,-16) [-16|15.99951171875] "V"  IOT_Gateway
 SG_ UCellBattPwrHi_11_7 : 96|16@1+ (0.00048828125,-16) [-16|15.99951171875] "V"  IOT_Gateway
 SG_ UCellBattPwrHi_11_6 : 80|16@1+ (0.00048828125,-16) [-16|15.99951171875] "V"  IOT_Gateway
 SG_ UCellBattPwrHi_11_5 : 64|16@1+ (0.00048828125,-16) [-16|15.99951171875] "V"  IOT_Gateway
 SG_ UCellBattPwrHi_11_4 : 48|16@1+ (0.00048828125,-16) [-16|15.99951171875] "V"  IOT_Gateway
 SG_ UCellBattPwrHi_11_3 : 32|16@1+ (0.00048828125,-16) [-16|15.99951171875] "V"  IOT_Gateway
 SG_ UCellBattPwrHi_11_2 : 16|16@1+ (0.00048828125,-16) [-16|15.99951171875] "V"  IOT_Gateway
 SG_ UCellBattPwrHi_11_1 : 0|16@1+ (0.00048828125,-16) [-16|15.99951171875] "V"  IOT_Gateway

BO_ 35 UCellBattPwrHi_20: 16 BMC
 SG_ UCellBattPwrHi_10_16 : 112|16@1+ (0.00048828125,-16) [-16|15.99951171875] "V"  IOT_Gateway
 SG_ UCellBattPwrHi_10_15 : 96|16@1+ (0.00048828125,-16) [-16|15.99951171875] "V"  IOT_Gateway
 SG_ UCellBattPwrHi_10_14 : 80|16@1+ (0.00048828125,-16) [-16|15.99951171875] "V"  IOT_Gateway
 SG_ UCellBattPwrHi_10_13 : 64|16@1+ (0.00048828125,-16) [-16|15.99951171875] "V"  IOT_Gateway
 SG_ UCellBattPwrHi_10_12 : 48|16@1+ (0.00048828125,-16) [-16|15.99951171875] "V"  IOT_Gateway
 SG_ UCellBattPwrHi_10_11 : 32|16@1+ (0.00048828125,-16) [-16|15.99951171875] "V"  IOT_Gateway
 SG_ UCellBattPwrHi_10_10 : 16|16@1+ (0.00048828125,-16) [-16|15.99951171875] "V"  IOT_Gateway
 SG_ UCellBattPwrHi_10_9 : 0|16@1+ (0.00048828125,-16) [-16|15.99951171875] "V"  IOT_Gateway

BO_ 34 UCellBattPwrHi_19: 16 BMC
 SG_ UCellBattPwrHi_10_8 : 112|16@1+ (0.00048828125,-16) [-16|15.99951171875] "V"  IOT_Gateway
 SG_ UCellBattPwrHi_10_7 : 96|16@1+ (0.00048828125,-16) [-16|15.99951171875] "V"  IOT_Gateway
 SG_ UCellBattPwrHi_10_6 : 80|16@1+ (0.00048828125,-16) [-16|15.99951171875] "V"  IOT_Gateway
 SG_ UCellBattPwrHi_10_5 : 64|16@1+ (0.00048828125,-16) [-16|15.99951171875] "V"  IOT_Gateway
 SG_ UCellBattPwrHi_10_4 : 48|16@1+ (0.00048828125,-16) [-16|15.99951171875] "V"  IOT_Gateway
 SG_ UCellBattPwrHi_10_3 : 32|16@1+ (0.00048828125,-16) [-16|15.99951171875] "V"  IOT_Gateway
 SG_ UCellBattPwrHi_10_2 : 16|16@1+ (0.00048828125,-16) [-16|15.99951171875] "V"  IOT_Gateway
 SG_ UCellBattPwrHi_10_1 : 0|16@1+ (0.00048828125,-16) [-16|15.99951171875] "V"  IOT_Gateway

BO_ 33 UCellBattPwrHi_18: 16 BMC
 SG_ UCellBattPwrHi_9_16 : 112|16@1+ (0.00048828125,-16) [-16|15.99951171875] "V"  IOT_Gateway
 SG_ UCellBattPwrHi_9_15 : 96|16@1+ (0.00048828125,-16) [-16|15.99951171875] "V"  IOT_Gateway
 SG_ UCellBattPwrHi_9_14 : 80|16@1+ (0.00048828125,-16) [-16|15.99951171875] "V"  IOT_Gateway
 SG_ UCellBattPwrHi_9_13 : 64|16@1+ (0.00048828125,-16) [-16|15.99951171875] "V"  IOT_Gateway
 SG_ UCellBattPwrHi_9_12 : 48|16@1+ (0.00048828125,-16) [-16|15.99951171875] "V"  IOT_Gateway
 SG_ UCellBattPwrHi_9_11 : 32|16@1+ (0.00048828125,-16) [-16|15.99951171875] "V"  IOT_Gateway
 SG_ UCellBattPwrHi_9_10 : 16|16@1+ (0.00048828125,-16) [-16|15.99951171875] "V"  IOT_Gateway
 SG_ UCellBattPwrHi_9_9 : 0|16@1+ (0.00048828125,-16) [-16|15.99951171875] "V"  IOT_Gateway

BO_ 32 UCellBattPwrHi_17: 16 BMC
 SG_ UCellBattPwrHi_9_8 : 112|16@1+ (0.00048828125,-16) [-16|15.99951171875] "V"  IOT_Gateway
 SG_ UCellBattPwrHi_9_7 : 96|16@1+ (0.00048828125,-16) [-16|15.99951171875] "V"  IOT_Gateway
 SG_ UCellBattPwrHi_9_6 : 80|16@1+ (0.00048828125,-16) [-16|15.99951171875] "V"  IOT_Gateway
 SG_ UCellBattPwrHi_9_5 : 64|16@1+ (0.00048828125,-16) [-16|15.99951171875] "V"  IOT_Gateway
 SG_ UCellBattPwrHi_9_4 : 48|16@1+ (0.00048828125,-16) [-16|15.99951171875] "V"  IOT_Gateway
 SG_ UCellBattPwrHi_9_3 : 32|16@1+ (0.00048828125,-16) [-16|15.99951171875] "V"  IOT_Gateway
 SG_ UCellBattPwrHi_9_2 : 16|16@1+ (0.00048828125,-16) [-16|15.99951171875] "V"  IOT_Gateway
 SG_ UCellBattPwrHi_9_1 : 0|16@1+ (0.00048828125,-16) [-16|15.99951171875] "V"  IOT_Gateway

BO_ 31 UCellBattPwrHi_16: 16 BMC
 SG_ UCellBattPwrHi_8_16 : 112|16@1+ (0.00048828125,-16) [-16|15.99951171875] "V"  IOT_Gateway
 SG_ UCellBattPwrHi_8_15 : 96|16@1+ (0.00048828125,-16) [-16|15.99951171875] "V"  IOT_Gateway
 SG_ UCellBattPwrHi_8_14 : 80|16@1+ (0.00048828125,-16) [-16|15.99951171875] "V"  IOT_Gateway
 SG_ UCellBattPwrHi_8_13 : 64|16@1+ (0.00048828125,-16) [-16|15.99951171875] "V"  IOT_Gateway
 SG_ UCellBattPwrHi_8_12 : 48|16@1+ (0.00048828125,-16) [-16|15.99951171875] "V"  IOT_Gateway
 SG_ UCellBattPwrHi_8_11 : 32|16@1+ (0.00048828125,-16) [-16|15.99951171875] "V"  IOT_Gateway
 SG_ UCellBattPwrHi_8_10 : 16|16@1+ (0.00048828125,-16) [-16|15.99951171875] "V"  IOT_Gateway
 SG_ UCellBattPwrHi_8_9 : 0|16@1+ (0.00048828125,-16) [-16|15.99951171875] "V"  IOT_Gateway

BO_ 30 UCellBattPwrHi_15: 16 BMC
 SG_ UCellBattPwrHi_8_8 : 112|16@1+ (0.00048828125,-16) [-16|15.99951171875] "V"  IOT_Gateway
 SG_ UCellBattPwrHi_8_7 : 96|16@1+ (0.00048828125,-16) [-16|15.99951171875] "V"  IOT_Gateway
 SG_ UCellBattPwrHi_8_6 : 80|16@1+ (0.00048828125,-16) [-16|15.99951171875] "V"  IOT_Gateway
 SG_ UCellBattPwrHi_8_5 : 64|16@1+ (0.00048828125,-16) [-16|15.99951171875] "V"  IOT_Gateway
 SG_ UCellBattPwrHi_8_4 : 48|16@1+ (0.00048828125,-16) [-16|15.99951171875] "V"  IOT_Gateway
 SG_ UCellBattPwrHi_8_3 : 32|16@1+ (0.00048828125,-16) [-16|15.99951171875] "V"  IOT_Gateway
 SG_ UCellBattPwrHi_8_2 : 16|16@1+ (0.00048828125,-16) [-16|15.99951171875] "V"  IOT_Gateway
 SG_ UCellBattPwrHi_8_1 : 0|16@1+ (0.00048828125,-16) [-16|15.99951171875] "V"  IOT_Gateway

BO_ 29 UCellBattPwrHi_14: 16 BMC
 SG_ UCellBattPwrHi_7_16 : 112|16@1+ (0.00048828125,-16) [-16|15.99951171875] "V"  IOT_Gateway
 SG_ UCellBattPwrHi_7_15 : 96|16@1+ (0.00048828125,-16) [-16|15.99951171875] "V"  IOT_Gateway
 SG_ UCellBattPwrHi_7_14 : 80|16@1+ (0.00048828125,-16) [-16|15.99951171875] "V"  IOT_Gateway
 SG_ UCellBattPwrHi_7_13 : 64|16@1+ (0.00048828125,-16) [-16|15.99951171875] "V"  IOT_Gateway
 SG_ UCellBattPwrHi_7_12 : 48|16@1+ (0.00048828125,-16) [-16|15.99951171875] "V"  IOT_Gateway
 SG_ UCellBattPwrHi_7_11 : 32|16@1+ (0.00048828125,-16) [-16|15.99951171875] "V"  IOT_Gateway
 SG_ UCellBattPwrHi_7_10 : 16|16@1+ (0.00048828125,-16) [-16|15.99951171875] "V"  IOT_Gateway
 SG_ UCellBattPwrHi_7_9 : 0|16@1+ (0.00048828125,-16) [-16|15.99951171875] "V"  IOT_Gateway

BO_ 28 UCellBattPwrHi_13: 16 BMC
 SG_ UCellBattPwrHi_7_8 : 112|16@1+ (0.00048828125,-16) [-16|15.99951171875] "V"  IOT_Gateway
 SG_ UCellBattPwrHi_7_7 : 96|16@1+ (0.00048828125,-16) [-16|15.99951171875] "V"  IOT_Gateway
 SG_ UCellBattPwrHi_7_6 : 80|16@1+ (0.00048828125,-16) [-16|15.99951171875] "V"  IOT_Gateway
 SG_ UCellBattPwrHi_7_5 : 64|16@1+ (0.00048828125,-16) [-16|15.99951171875] "V"  IOT_Gateway
 SG_ UCellBattPwrHi_7_4 : 48|16@1+ (0.00048828125,-16) [-16|15.99951171875] "V"  IOT_Gateway
 SG_ UCellBattPwrHi_7_3 : 32|16@1+ (0.00048828125,-16) [-16|15.99951171875] "V"  IOT_Gateway
 SG_ UCellBattPwrHi_7_2 : 16|16@1+ (0.00048828125,-16) [-16|15.99951171875] "V"  IOT_Gateway
 SG_ UCellBattPwrHi_7_1 : 0|16@1+ (0.00048828125,-16) [-16|15.99951171875] "V"  IOT_Gateway

BO_ 27 UCellBattPwrHi_12: 16 BMC
 SG_ UCellBattPwrHi_6_16 : 112|16@1+ (0.00048828125,-16) [-16|15.99951171875] "V"  IOT_Gateway
 SG_ UCellBattPwrHi_6_15 : 96|16@1+ (0.00048828125,-16) [-16|15.99951171875] "V"  IOT_Gateway
 SG_ UCellBattPwrHi_6_14 : 80|16@1+ (0.00048828125,-16) [-16|15.99951171875] "V"  IOT_Gateway
 SG_ UCellBattPwrHi_6_13 : 64|16@1+ (0.00048828125,-16) [-16|15.99951171875] "V"  IOT_Gateway
 SG_ UCellBattPwrHi_6_12 : 48|16@1+ (0.00048828125,-16) [-16|15.99951171875] "V"  IOT_Gateway
 SG_ UCellBattPwrHi_6_11 : 32|16@1+ (0.00048828125,-16) [-16|15.99951171875] "V"  IOT_Gateway
 SG_ UCellBattPwrHi_6_10 : 16|16@1+ (0.00048828125,-16) [-16|15.99951171875] "V"  IOT_Gateway
 SG_ UCellBattPwrHi_6_9 : 0|16@1+ (0.00048828125,-16) [-16|15.99951171875] "V"  IOT_Gateway

BO_ 26 UCellBattPwrHi_11: 16 BMC
 SG_ UCellBattPwrHi_6_8 : 112|16@1+ (0.00048828125,-16) [-16|15.99951171875] "V"  IOT_Gateway
 SG_ UCellBattPwrHi_6_7 : 96|16@1+ (0.00048828125,-16) [-16|15.99951171875] "V"  IOT_Gateway
 SG_ UCellBattPwrHi_6_6 : 80|16@1+ (0.00048828125,-16) [-16|15.99951171875] "V"  IOT_Gateway
 SG_ UCellBattPwrHi_6_5 : 64|16@1+ (0.00048828125,-16) [-16|15.99951171875] "V"  IOT_Gateway
 SG_ UCellBattPwrHi_6_4 : 48|16@1+ (0.00048828125,-16) [-16|15.99951171875] "V"  IOT_Gateway
 SG_ UCellBattPwrHi_6_3 : 32|16@1+ (0.00048828125,-16) [-16|15.99951171875] "V"  IOT_Gateway
 SG_ UCellBattPwrHi_6_2 : 16|16@1+ (0.00048828125,-16) [-16|15.99951171875] "V"  IOT_Gateway
 SG_ UCellBattPwrHi_6_1 : 0|16@1+ (0.00048828125,-16) [-16|15.99951171875] "V"  IOT_Gateway

BO_ 25 UCellBattPwrHi_10: 16 BMC
 SG_ UCellBattPwrHi_5_16 : 112|16@1+ (0.00048828125,-16) [-16|15.99951171875] "V"  IOT_Gateway
 SG_ UCellBattPwrHi_5_15 : 96|16@1+ (0.00048828125,-16) [-16|15.99951171875] "V"  IOT_Gateway
 SG_ UCellBattPwrHi_5_14 : 80|16@1+ (0.00048828125,-16) [-16|15.99951171875] "V"  IOT_Gateway
 SG_ UCellBattPwrHi_5_13 : 64|16@1+ (0.00048828125,-16) [-16|15.99951171875] "V"  IOT_Gateway
 SG_ UCellBattPwrHi_5_12 : 48|16@1+ (0.00048828125,-16) [-16|15.99951171875] "V"  IOT_Gateway
 SG_ UCellBattPwrHi_5_11 : 32|16@1+ (0.00048828125,-16) [-16|15.99951171875] "V"  IOT_Gateway
 SG_ UCellBattPwrHi_5_10 : 16|16@1+ (0.00048828125,-16) [-16|15.99951171875] "V"  IOT_Gateway
 SG_ UCellBattPwrHi_5_9 : 0|16@1+ (0.00048828125,-16) [-16|15.99951171875] "V"  IOT_Gateway

BO_ 24 UCellBattPwrHi_9: 16 BMC
 SG_ UCellBattPwrHi_5_8 : 112|16@1+ (0.00048828125,-16) [-16|15.99951171875] "V"  IOT_Gateway
 SG_ UCellBattPwrHi_5_7 : 96|16@1+ (0.00048828125,-16) [-16|15.99951171875] "V"  IOT_Gateway
 SG_ UCellBattPwrHi_5_6 : 80|16@1+ (0.00048828125,-16) [-16|15.99951171875] "V"  IOT_Gateway
 SG_ UCellBattPwrHi_5_5 : 64|16@1+ (0.00048828125,-16) [-16|15.99951171875] "V"  IOT_Gateway
 SG_ UCellBattPwrHi_5_4 : 48|16@1+ (0.00048828125,-16) [-16|15.99951171875] "V"  IOT_Gateway
 SG_ UCellBattPwrHi_5_3 : 32|16@1+ (0.00048828125,-16) [-16|15.99951171875] "V"  IOT_Gateway
 SG_ UCellBattPwrHi_5_2 : 16|16@1+ (0.00048828125,-16) [-16|15.99951171875] "V"  IOT_Gateway
 SG_ UCellBattPwrHi_5_1 : 0|16@1+ (0.00048828125,-16) [-16|15.99951171875] "V"  IOT_Gateway

BO_ 23 UCellBattPwrHi_8: 16 BMC
 SG_ UCellBattPwrHi_4_16 : 112|16@1+ (0.00048828125,-16) [-16|15.99951171875] "V"  IOT_Gateway
 SG_ UCellBattPwrHi_4_15 : 96|16@1+ (0.00048828125,-16) [-16|15.99951171875] "V"  IOT_Gateway
 SG_ UCellBattPwrHi_4_14 : 80|16@1+ (0.00048828125,-16) [-16|15.99951171875] "V"  IOT_Gateway
 SG_ UCellBattPwrHi_4_13 : 64|16@1+ (0.00048828125,-16) [-16|15.99951171875] "V"  IOT_Gateway
 SG_ UCellBattPwrHi_4_12 : 48|16@1+ (0.00048828125,-16) [-16|15.99951171875] "V"  IOT_Gateway
 SG_ UCellBattPwrHi_4_11 : 32|16@1+ (0.00048828125,-16) [-16|15.99951171875] "V"  IOT_Gateway
 SG_ UCellBattPwrHi_4_10 : 16|16@1+ (0.00048828125,-16) [-16|15.99951171875] "V"  IOT_Gateway
 SG_ UCellBattPwrHi_4_9 : 0|16@1+ (0.00048828125,-16) [-16|15.99951171875] "V"  IOT_Gateway

BO_ 22 UCellBattPwrHi_7: 16 BMC
 SG_ UCellBattPwrHi_4_8 : 112|16@1+ (0.00048828125,-16) [-16|15.99951171875] "V"  IOT_Gateway
 SG_ UCellBattPwrHi_4_7 : 96|16@1+ (0.00048828125,-16) [-16|15.99951171875] "V"  IOT_Gateway
 SG_ UCellBattPwrHi_4_6 : 80|16@1+ (0.00048828125,-16) [-16|15.99951171875] "V"  IOT_Gateway
 SG_ UCellBattPwrHi_4_5 : 64|16@1+ (0.00048828125,-16) [-16|15.99951171875] "V"  IOT_Gateway
 SG_ UCellBattPwrHi_4_4 : 48|16@1+ (0.00048828125,-16) [-16|15.99951171875] "V"  IOT_Gateway
 SG_ UCellBattPwrHi_4_3 : 32|16@1+ (0.00048828125,-16) [-16|15.99951171875] "V"  IOT_Gateway
 SG_ UCellBattPwrHi_4_2 : 16|16@1+ (0.00048828125,-16) [-16|15.99951171875] "V"  IOT_Gateway
 SG_ UCellBattPwrHi_4_1 : 0|16@1+ (0.00048828125,-16) [-16|15.99951171875] "V"  IOT_Gateway

BO_ 21 UCellBattPwrHi_6: 16 BMC
 SG_ UCellBattPwrHi_3_16 : 112|16@1+ (0.00048828125,-16) [-16|15.99951171875] "V"  IOT_Gateway
 SG_ UCellBattPwrHi_3_15 : 96|16@1+ (0.00048828125,-16) [-16|15.99951171875] "V"  IOT_Gateway
 SG_ UCellBattPwrHi_3_14 : 80|16@1+ (0.00048828125,-16) [-16|15.99951171875] "V"  IOT_Gateway
 SG_ UCellBattPwrHi_3_13 : 64|16@1+ (0.00048828125,-16) [-16|15.99951171875] "V"  IOT_Gateway
 SG_ UCellBattPwrHi_3_12 : 48|16@1+ (0.00048828125,-16) [-16|15.99951171875] "V"  IOT_Gateway
 SG_ UCellBattPwrHi_3_11 : 32|16@1+ (0.00048828125,-16) [-16|15.99951171875] "V"  IOT_Gateway
 SG_ UCellBattPwrHi_3_10 : 16|16@1+ (0.00048828125,-16) [-16|15.99951171875] "V"  IOT_Gateway
 SG_ UCellBattPwrHi_3_9 : 0|16@1+ (0.00048828125,-16) [-16|15.99951171875] "V"  IOT_Gateway

BO_ 20 UCellBattPwrHi_5: 16 BMC
 SG_ UCellBattPwrHi_3_8 : 112|16@1+ (0.00048828125,-16) [-16|15.99951171875] "V"  IOT_Gateway
 SG_ UCellBattPwrHi_3_7 : 96|16@1+ (0.00048828125,-16) [-16|15.99951171875] "V"  IOT_Gateway
 SG_ UCellBattPwrHi_3_6 : 80|16@1+ (0.00048828125,-16) [-16|15.99951171875] "V"  IOT_Gateway
 SG_ UCellBattPwrHi_3_5 : 64|16@1+ (0.00048828125,-16) [-16|15.99951171875] "V"  IOT_Gateway
 SG_ UCellBattPwrHi_3_4 : 48|16@1+ (0.00048828125,-16) [-16|15.99951171875] "V"  IOT_Gateway
 SG_ UCellBattPwrHi_3_3 : 32|16@1+ (0.00048828125,-16) [-16|15.99951171875] "V"  IOT_Gateway
 SG_ UCellBattPwrHi_3_2 : 16|16@1+ (0.00048828125,-16) [-16|15.99951171875] "V"  IOT_Gateway
 SG_ UCellBattPwrHi_3_1 : 0|16@1+ (0.00048828125,-16) [-16|15.99951171875] "V"  IOT_Gateway

BO_ 19 UCellBattPwrHi_4: 16 BMC
 SG_ UCellBattPwrHi_2_16 : 112|16@1+ (0.00048828125,-16) [-16|15.99951171875] "V"  IOT_Gateway
 SG_ UCellBattPwrHi_2_15 : 96|16@1+ (0.00048828125,-16) [-16|15.99951171875] "V"  IOT_Gateway
 SG_ UCellBattPwrHi_2_14 : 80|16@1+ (0.00048828125,-16) [-16|15.99951171875] "V"  IOT_Gateway
 SG_ UCellBattPwrHi_2_13 : 64|16@1+ (0.00048828125,-16) [-16|15.99951171875] "V"  IOT_Gateway
 SG_ UCellBattPwrHi_2_12 : 48|16@1+ (0.00048828125,-16) [-16|15.99951171875] "V"  IOT_Gateway
 SG_ UCellBattPwrHi_2_11 : 32|16@1+ (0.00048828125,-16) [-16|15.99951171875] "V"  IOT_Gateway
 SG_ UCellBattPwrHi_2_10 : 16|16@1+ (0.00048828125,-16) [-16|15.99951171875] "V"  IOT_Gateway
 SG_ UCellBattPwrHi_2_9 : 0|16@1+ (0.00048828125,-16) [-16|15.99951171875] "V"  IOT_Gateway

BO_ 18 UCellBattPwrHi_3: 16 BMC
 SG_ UCellBattPwrHi_2_8 : 112|16@1+ (0.00048828125,-16) [-16|15.99951171875] "V"  IOT_Gateway
 SG_ UCellBattPwrHi_2_7 : 96|16@1+ (0.00048828125,-16) [-16|15.99951171875] "V"  IOT_Gateway
 SG_ UCellBattPwrHi_2_6 : 80|16@1+ (0.00048828125,-16) [-16|15.99951171875] "V"  IOT_Gateway
 SG_ UCellBattPwrHi_2_5 : 64|16@1+ (0.00048828125,-16) [-16|15.99951171875] "V"  IOT_Gateway
 SG_ UCellBattPwrHi_2_4 : 48|16@1+ (0.00048828125,-16) [-16|15.99951171875] "V"  IOT_Gateway
 SG_ UCellBattPwrHi_2_3 : 32|16@1+ (0.00048828125,-16) [-16|15.99951171875] "V"  IOT_Gateway
 SG_ UCellBattPwrHi_2_2 : 16|16@1+ (0.00048828125,-16) [-16|15.99951171875] "V"  IOT_Gateway
 SG_ UCellBattPwrHi_2_1 : 0|16@1+ (0.00048828125,-16) [-16|15.99951171875] "V"  IOT_Gateway

BO_ 17 UCellBattPwrHi_2: 16 BMC
 SG_ UCellBattPwrHi_1_16 : 112|16@1+ (0.00048828125,-16) [-16|15.99951171875] "V"  IOT_Gateway
 SG_ UCellBattPwrHi_1_15 : 96|16@1+ (0.00048828125,-16) [-16|15.99951171875] "V"  IOT_Gateway
 SG_ UCellBattPwrHi_1_14 : 80|16@1+ (0.00048828125,-16) [-16|15.99951171875] "V"  IOT_Gateway
 SG_ UCellBattPwrHi_1_13 : 64|16@1+ (0.00048828125,-16) [-16|15.99951171875] "V"  IOT_Gateway
 SG_ UCellBattPwrHi_1_12 : 48|16@1+ (0.00048828125,-16) [-16|15.99951171875] "V"  IOT_Gateway
 SG_ UCellBattPwrHi_1_11 : 32|16@1+ (0.00048828125,-16) [-16|15.99951171875] "V"  IOT_Gateway
 SG_ UCellBattPwrHi_1_10 : 16|16@1+ (0.00048828125,-16) [-16|15.99951171875] "V"  IOT_Gateway
 SG_ UCellBattPwrHi_1_9 : 0|16@1+ (0.00048828125,-16) [-16|15.99951171875] "V"  IOT_Gateway

BO_ 16 UCellBattPwrHi_1: 16 BMC
 SG_ UCellBattPwrHi_1_8 : 112|16@1+ (0.00048828125,-16) [-16|15.99951171875] "V"  IOT_Gateway
 SG_ UCellBattPwrHi_1_7 : 96|16@1+ (0.00048828125,-16) [-16|15.99951171875] "V"  IOT_Gateway
 SG_ UCellBattPwrHi_1_6 : 80|16@1+ (0.00048828125,-16) [-16|15.99951171875] "V"  IOT_Gateway
 SG_ UCellBattPwrHi_1_5 : 64|16@1+ (0.00048828125,-16) [-16|15.99951171875] "V"  IOT_Gateway
 SG_ UCellBattPwrHi_1_4 : 48|16@1+ (0.00048828125,-16) [-16|15.99951171875] "V"  IOT_Gateway
 SG_ UCellBattPwrHi_1_3 : 32|16@1+ (0.00048828125,-16) [-16|15.99951171875] "V"  IOT_Gateway
 SG_ UCellBattPwrHi_1_2 : 16|16@1+ (0.00048828125,-16) [-16|15.99951171875] "V"  IOT_Gateway
 SG_ UCellBattPwrHi_1_1 : 0|16@1+ (0.00048828125,-16) [-16|15.99951171875] "V"  IOT_Gateway

CM_ SG_ 112 RatChaCellBattPwrHi_2_16 "High power battery state of charge on cell level";
CM_ SG_ 112 RatChaCellBattPwrHi_2_15 "High power battery state of charge on cell level";
CM_ SG_ 112 RatChaCellBattPwrHi_2_14 "High power battery state of charge on cell level";
CM_ SG_ 112 RatChaCellBattPwrHi_2_13 "High power battery state of charge on cell level";
CM_ SG_ 112 RatChaCellBattPwrHi_2_12 "High power battery state of charge on cell level";
CM_ SG_ 112 RatChaCellBattPwrHi_2_11 "High power battery state of charge on cell level";
CM_ SG_ 112 RatChaCellBattPwrHi_2_10 "High power battery state of charge on cell level";
CM_ SG_ 112 RatChaCellBattPwrHi_2_9 "High power battery state of charge on cell level";
CM_ SG_ 112 RatChaCellBattPwrHi_2_8 "High power battery state of charge on cell level";
CM_ SG_ 112 RatChaCellBattPwrHi_2_7 "High power battery state of charge on cell level";
CM_ SG_ 112 RatChaCellBattPwrHi_2_6 "High power battery state of charge on cell level";
CM_ SG_ 112 RatChaCellBattPwrHi_2_5 "High power battery state of charge on cell level";
CM_ SG_ 112 RatChaCellBattPwrHi_2_4 "High power battery state of charge on cell level";
CM_ SG_ 112 RatChaCellBattPwrHi_2_3 "High power battery state of charge on cell level";
CM_ SG_ 112 RatChaCellBattPwrHi_2_2 "High power battery state of charge on cell level";
CM_ SG_ 112 RatChaCellBattPwrHi_2_1 "High power battery state of charge on cell level";
CM_ SG_ 112 RatChaCellBattPwrHi_1_16 "High power battery state of charge on cell level";
CM_ SG_ 112 RatChaCellBattPwrHi_1_15 "High power battery state of charge on cell level";
CM_ SG_ 112 RatChaCellBattPwrHi_1_14 "High power battery state of charge on cell level";
CM_ SG_ 112 RatChaCellBattPwrHi_1_13 "High power battery state of charge on cell level";
CM_ SG_ 112 RatChaCellBattPwrHi_1_12 "High power battery state of charge on cell level";
CM_ SG_ 112 RatChaCellBattPwrHi_1_11 "High power battery state of charge on cell level";
CM_ SG_ 112 RatChaCellBattPwrHi_1_10 "High power battery state of charge on cell level";
CM_ SG_ 112 RatChaCellBattPwrHi_1_9 "High power battery state of charge on cell level";
CM_ SG_ 112 RatChaCellBattPwrHi_1_8 "High power battery state of charge on cell level";
CM_ SG_ 112 RatChaCellBattPwrHi_1_7 "High power battery state of charge on cell level";
CM_ SG_ 112 RatChaCellBattPwrHi_1_6 "High power battery state of charge on cell level";
CM_ SG_ 112 RatChaCellBattPwrHi_1_5 "High power battery state of charge on cell level";
CM_ SG_ 112 RatChaCellBattPwrHi_1_4 "High power battery state of charge on cell level";
CM_ SG_ 112 RatChaCellBattPwrHi_1_3 "High power battery state of charge on cell level";
CM_ SG_ 112 RatChaCellBattPwrHi_1_2 "High power battery state of charge on cell level";
CM_ SG_ 112 RatChaCellBattPwrHi_1_1 "High power battery state of charge on cell level";
CM_ SG_ 107 TCellBattEgyHi_12_6 "High energy battery cell temperatures";
CM_ SG_ 107 TCellBattEgyHi_12_5 "High energy battery cell temperatures";
CM_ SG_ 107 TCellBattEgyHi_12_4 "High energy battery cell temperatures";
CM_ SG_ 107 TCellBattEgyHi_12_3 "High energy battery cell temperatures";
CM_ SG_ 107 TCellBattEgyHi_12_2 "High energy battery cell temperatures";
CM_ SG_ 107 TCellBattEgyHi_12_1 "High energy battery cell temperatures";
CM_ SG_ 106 TCellBattEgyHi_11_6 "High energy battery cell temperatures";
CM_ SG_ 106 TCellBattEgyHi_11_5 "High energy battery cell temperatures";
CM_ SG_ 106 TCellBattEgyHi_11_4 "High energy battery cell temperatures";
CM_ SG_ 106 TCellBattEgyHi_11_3 "High energy battery cell temperatures";
CM_ SG_ 106 TCellBattEgyHi_11_2 "High energy battery cell temperatures";
CM_ SG_ 106 TCellBattEgyHi_11_1 "High energy battery cell temperatures";
CM_ SG_ 105 TCellBattEgyHi_10_6 "High energy battery cell temperatures";
CM_ SG_ 105 TCellBattEgyHi_10_5 "High energy battery cell temperatures";
CM_ SG_ 105 TCellBattEgyHi_10_4 "High energy battery cell temperatures";
CM_ SG_ 105 TCellBattEgyHi_10_3 "High energy battery cell temperatures";
CM_ SG_ 105 TCellBattEgyHi_10_2 "High energy battery cell temperatures";
CM_ SG_ 105 TCellBattEgyHi_10_1 "High energy battery cell temperatures";
CM_ SG_ 104 TCellBattEgyHi_9_6 "High energy battery cell temperatures";
CM_ SG_ 104 TCellBattEgyHi_9_5 "High energy battery cell temperatures";
CM_ SG_ 104 TCellBattEgyHi_9_4 "High energy battery cell temperatures";
CM_ SG_ 104 TCellBattEgyHi_9_3 "High energy battery cell temperatures";
CM_ SG_ 104 TCellBattEgyHi_9_2 "High energy battery cell temperatures";
CM_ SG_ 104 TCellBattEgyHi_9_1 "High energy battery cell temperatures";
CM_ SG_ 103 TCellBattEgyHi_8_6 "High energy battery cell temperatures";
CM_ SG_ 103 TCellBattEgyHi_8_5 "High energy battery cell temperatures";
CM_ SG_ 103 TCellBattEgyHi_8_4 "High energy battery cell temperatures";
CM_ SG_ 103 TCellBattEgyHi_8_3 "High energy battery cell temperatures";
CM_ SG_ 103 TCellBattEgyHi_8_2 "High energy battery cell temperatures";
CM_ SG_ 103 TCellBattEgyHi_8_1 "High energy battery cell temperatures";
CM_ SG_ 102 TCellBattEgyHi_7_6 "High energy battery cell temperatures";
CM_ SG_ 102 TCellBattEgyHi_7_5 "High energy battery cell temperatures";
CM_ SG_ 102 TCellBattEgyHi_7_4 "High energy battery cell temperatures";
CM_ SG_ 102 TCellBattEgyHi_7_3 "High energy battery cell temperatures";
CM_ SG_ 102 TCellBattEgyHi_7_2 "High energy battery cell temperatures";
CM_ SG_ 102 TCellBattEgyHi_7_1 "High energy battery cell temperatures";
CM_ SG_ 101 TCellBattEgyHi_6_6 "High energy battery cell temperatures";
CM_ SG_ 101 TCellBattEgyHi_6_5 "High energy battery cell temperatures";
CM_ SG_ 101 TCellBattEgyHi_6_4 "High energy battery cell temperatures";
CM_ SG_ 101 TCellBattEgyHi_6_3 "High energy battery cell temperatures";
CM_ SG_ 101 TCellBattEgyHi_6_2 "High energy battery cell temperatures";
CM_ SG_ 101 TCellBattEgyHi_6_1 "High energy battery cell temperatures";
CM_ SG_ 100 TCellBattEgyHi_5_6 "High energy battery cell temperatures";
CM_ SG_ 100 TCellBattEgyHi_5_5 "High energy battery cell temperatures";
CM_ SG_ 100 TCellBattEgyHi_5_4 "High energy battery cell temperatures";
CM_ SG_ 100 TCellBattEgyHi_5_3 "High energy battery cell temperatures";
CM_ SG_ 100 TCellBattEgyHi_5_2 "High energy battery cell temperatures";
CM_ SG_ 100 TCellBattEgyHi_5_1 "High energy battery cell temperatures";
CM_ SG_ 99 TCellBattEgyHi_4_6 "High energy battery cell temperatures";
CM_ SG_ 99 TCellBattEgyHi_4_5 "High energy battery cell temperatures";
CM_ SG_ 99 TCellBattEgyHi_4_4 "High energy battery cell temperatures";
CM_ SG_ 99 TCellBattEgyHi_4_3 "High energy battery cell temperatures";
CM_ SG_ 99 TCellBattEgyHi_4_2 "High energy battery cell temperatures";
CM_ SG_ 99 TCellBattEgyHi_4_1 "High energy battery cell temperatures";
CM_ SG_ 98 TCellBattEgyHi_3_6 "High energy battery cell temperatures";
CM_ SG_ 98 TCellBattEgyHi_3_5 "High energy battery cell temperatures";
CM_ SG_ 98 TCellBattEgyHi_3_4 "High energy battery cell temperatures";
CM_ SG_ 98 TCellBattEgyHi_3_3 "High energy battery cell temperatures";
CM_ SG_ 98 TCellBattEgyHi_3_2 "High energy battery cell temperatures";
CM_ SG_ 98 TCellBattEgyHi_3_1 "High energy battery cell temperatures";
CM_ SG_ 97 TCellBattEgyHi_2_6 "High energy battery cell temperatures";
CM_ SG_ 97 TCellBattEgyHi_2_5 "High energy battery cell temperatures";
CM_ SG_ 97 TCellBattEgyHi_2_4 "High energy battery cell temperatures";
CM_ SG_ 97 TCellBattEgyHi_2_3 "High energy battery cell temperatures";
CM_ SG_ 97 TCellBattEgyHi_2_2 "High energy battery cell temperatures";
CM_ SG_ 97 TCellBattEgyHi_2_1 "High energy battery cell temperatures";
CM_ SG_ 96 TCellBattEgyHi_1_6 "High energy battery cell temperatures";
CM_ SG_ 96 TCellBattEgyHi_1_5 "High energy battery cell temperatures";
CM_ SG_ 96 TCellBattEgyHi_1_4 "High energy battery cell temperatures";
CM_ SG_ 96 TCellBattEgyHi_1_3 "High energy battery cell temperatures";
CM_ SG_ 96 TCellBattEgyHi_1_2 "High energy battery cell temperatures";
CM_ SG_ 96 TCellBattEgyHi_1_1 "High energy battery cell temperatures";
CM_ SG_ 91 TCellBattPwrHi_12_6 "High power battery cell temperatures";
CM_ SG_ 91 TCellBattPwrHi_12_5 "High power battery cell temperatures";
CM_ SG_ 91 TCellBattPwrHi_12_4 "High power battery cell temperatures";
CM_ SG_ 91 TCellBattPwrHi_12_3 "High power battery cell temperatures";
CM_ SG_ 91 TCellBattPwrHi_12_2 "High power battery cell temperatures";
CM_ SG_ 91 TCellBattPwrHi_12_1 "High power battery cell temperatures";
CM_ SG_ 90 TCellBattPwrHi_11_6 "High power battery cell temperatures";
CM_ SG_ 90 TCellBattPwrHi_11_5 "High power battery cell temperatures";
CM_ SG_ 90 TCellBattPwrHi_11_4 "High power battery cell temperatures";
CM_ SG_ 90 TCellBattPwrHi_11_3 "High power battery cell temperatures";
CM_ SG_ 90 TCellBattPwrHi_11_2 "High power battery cell temperatures";
CM_ SG_ 90 TCellBattPwrHi_11_1 "High power battery cell temperatures";
CM_ SG_ 89 TCellBattPwrHi_10_6 "High power battery cell temperatures";
CM_ SG_ 89 TCellBattPwrHi_10_5 "High power battery cell temperatures";
CM_ SG_ 89 TCellBattPwrHi_10_4 "High power battery cell temperatures";
CM_ SG_ 89 TCellBattPwrHi_10_3 "High power battery cell temperatures";
CM_ SG_ 89 TCellBattPwrHi_10_2 "High power battery cell temperatures";
CM_ SG_ 89 TCellBattPwrHi_10_1 "High power battery cell temperatures";
CM_ SG_ 88 TCellBattPwrHi_9_6 "High power battery cell temperatures";
CM_ SG_ 88 TCellBattPwrHi_9_5 "High power battery cell temperatures";
CM_ SG_ 88 TCellBattPwrHi_9_4 "High power battery cell temperatures";
CM_ SG_ 88 TCellBattPwrHi_9_3 "High power battery cell temperatures";
CM_ SG_ 88 TCellBattPwrHi_9_2 "High power battery cell temperatures";
CM_ SG_ 88 TCellBattPwrHi_9_1 "High power battery cell temperatures";
CM_ SG_ 87 TCellBattPwrHi_8_6 "High power battery cell temperatures";
CM_ SG_ 87 TCellBattPwrHi_8_5 "High power battery cell temperatures";
CM_ SG_ 87 TCellBattPwrHi_8_4 "High power battery cell temperatures";
CM_ SG_ 87 TCellBattPwrHi_8_3 "High power battery cell temperatures";
CM_ SG_ 87 TCellBattPwrHi_8_2 "High power battery cell temperatures";
CM_ SG_ 87 TCellBattPwrHi_8_1 "High power battery cell temperatures";
CM_ SG_ 86 TCellBattPwrHi_7_6 "High power battery cell temperatures";
CM_ SG_ 86 TCellBattPwrHi_7_5 "High power battery cell temperatures";
CM_ SG_ 86 TCellBattPwrHi_7_4 "High power battery cell temperatures";
CM_ SG_ 86 TCellBattPwrHi_7_3 "High power battery cell temperatures";
CM_ SG_ 86 TCellBattPwrHi_7_2 "High power battery cell temperatures";
CM_ SG_ 86 TCellBattPwrHi_7_1 "High power battery cell temperatures";
CM_ SG_ 85 TCellBattPwrHi_6_6 "High power battery cell temperatures";
CM_ SG_ 85 TCellBattPwrHi_6_5 "High power battery cell temperatures";
CM_ SG_ 85 TCellBattPwrHi_6_4 "High power battery cell temperatures";
CM_ SG_ 85 TCellBattPwrHi_6_3 "High power battery cell temperatures";
CM_ SG_ 85 TCellBattPwrHi_6_2 "High power battery cell temperatures";
CM_ SG_ 85 TCellBattPwrHi_6_1 "High power battery cell temperatures";
CM_ SG_ 84 TCellBattPwrHi_5_6 "High power battery cell temperatures";
CM_ SG_ 84 TCellBattPwrHi_5_5 "High power battery cell temperatures";
CM_ SG_ 84 TCellBattPwrHi_5_4 "High power battery cell temperatures";
CM_ SG_ 84 TCellBattPwrHi_5_3 "High power battery cell temperatures";
CM_ SG_ 84 TCellBattPwrHi_5_2 "High power battery cell temperatures";
CM_ SG_ 84 TCellBattPwrHi_5_1 "High power battery cell temperatures";
CM_ SG_ 83 TCellBattPwrHi_4_6 "High power battery cell temperatures";
CM_ SG_ 83 TCellBattPwrHi_4_5 "High power battery cell temperatures";
CM_ SG_ 83 TCellBattPwrHi_4_4 "High power battery cell temperatures";
CM_ SG_ 83 TCellBattPwrHi_4_3 "High power battery cell temperatures";
CM_ SG_ 83 TCellBattPwrHi_4_2 "High power battery cell temperatures";
CM_ SG_ 83 TCellBattPwrHi_4_1 "High power battery cell temperatures";
CM_ SG_ 82 TCellBattPwrHi_3_6 "High power battery cell temperatures";
CM_ SG_ 82 TCellBattPwrHi_3_5 "High power battery cell temperatures";
CM_ SG_ 82 TCellBattPwrHi_3_4 "High power battery cell temperatures";
CM_ SG_ 82 TCellBattPwrHi_3_3 "High power battery cell temperatures";
CM_ SG_ 82 TCellBattPwrHi_3_2 "High power battery cell temperatures";
CM_ SG_ 82 TCellBattPwrHi_3_1 "High power battery cell temperatures";
CM_ SG_ 81 TCellBattPwrHi_2_6 "High power battery cell temperatures";
CM_ SG_ 81 TCellBattPwrHi_2_5 "High power battery cell temperatures";
CM_ SG_ 81 TCellBattPwrHi_2_4 "High power battery cell temperatures";
CM_ SG_ 81 TCellBattPwrHi_2_3 "High power battery cell temperatures";
CM_ SG_ 81 TCellBattPwrHi_2_2 "High power battery cell temperatures";
CM_ SG_ 81 TCellBattPwrHi_2_1 "High power battery cell temperatures";
CM_ SG_ 80 TCellBattPwrHi_1_6 "High power battery cell temperatures";
CM_ SG_ 80 TCellBattPwrHi_1_5 "High power battery cell temperatures";
CM_ SG_ 80 TCellBattPwrHi_1_4 "High power battery cell temperatures";
CM_ SG_ 80 TCellBattPwrHi_1_3 "High power battery cell temperatures";
CM_ SG_ 80 TCellBattPwrHi_1_2 "High power battery cell temperatures";
CM_ SG_ 80 TCellBattPwrHi_1_1 "High power battery cell temperatures";
CM_ SG_ 79 UCellBattEgyHi_16_16 "High energy battery cell voltages";
CM_ SG_ 79 UCellBattEgyHi_16_15 "High energy battery cell voltages";
CM_ SG_ 79 UCellBattEgyHi_16_14 "High energy battery cell voltages";
CM_ SG_ 79 UCellBattEgyHi_16_13 "High energy battery cell voltages";
CM_ SG_ 79 UCellBattEgyHi_16_12 "High energy battery cell voltages";
CM_ SG_ 79 UCellBattEgyHi_16_11 "High energy battery cell voltages";
CM_ SG_ 79 UCellBattEgyHi_16_10 "High energy battery cell voltages";
CM_ SG_ 79 UCellBattEgyHi_16_9 "High energy battery cell voltages";
CM_ SG_ 78 UCellBattEgyHi_16_8 "High energy battery cell voltages";
CM_ SG_ 78 UCellBattEgyHi_16_7 "High energy battery cell voltages";
CM_ SG_ 78 UCellBattEgyHi_16_6 "High energy battery cell voltages";
CM_ SG_ 78 UCellBattEgyHi_16_5 "High energy battery cell voltages";
CM_ SG_ 78 UCellBattEgyHi_16_4 "High energy battery cell voltages";
CM_ SG_ 78 UCellBattEgyHi_16_3 "High energy battery cell voltages";
CM_ SG_ 78 UCellBattEgyHi_16_2 "High energy battery cell voltages";
CM_ SG_ 78 UCellBattEgyHi_16_1 "High energy battery cell voltages";
CM_ SG_ 77 UCellBattEgyHi_15_16 "High energy battery cell voltages";
CM_ SG_ 77 UCellBattEgyHi_15_15 "High energy battery cell voltages";
CM_ SG_ 77 UCellBattEgyHi_15_14 "High energy battery cell voltages";
CM_ SG_ 77 UCellBattEgyHi_15_13 "High energy battery cell voltages";
CM_ SG_ 77 UCellBattEgyHi_15_12 "High energy battery cell voltages";
CM_ SG_ 77 UCellBattEgyHi_15_11 "High energy battery cell voltages";
CM_ SG_ 77 UCellBattEgyHi_15_10 "High energy battery cell voltages";
CM_ SG_ 77 UCellBattEgyHi_15_9 "High energy battery cell voltages";
CM_ SG_ 76 UCellBattEgyHi_15_8 "High energy battery cell voltages";
CM_ SG_ 76 UCellBattEgyHi_15_7 "High energy battery cell voltages";
CM_ SG_ 76 UCellBattEgyHi_15_6 "High energy battery cell voltages";
CM_ SG_ 76 UCellBattEgyHi_15_5 "High energy battery cell voltages";
CM_ SG_ 76 UCellBattEgyHi_15_4 "High energy battery cell voltages";
CM_ SG_ 76 UCellBattEgyHi_15_3 "High energy battery cell voltages";
CM_ SG_ 76 UCellBattEgyHi_15_2 "High energy battery cell voltages";
CM_ SG_ 76 UCellBattEgyHi_15_1 "High energy battery cell voltages";
CM_ SG_ 75 UCellBattEgyHi_14_16 "High energy battery cell voltages";
CM_ SG_ 75 UCellBattEgyHi_14_15 "High energy battery cell voltages";
CM_ SG_ 75 UCellBattEgyHi_14_14 "High energy battery cell voltages";
CM_ SG_ 75 UCellBattEgyHi_14_13 "High energy battery cell voltages";
CM_ SG_ 75 UCellBattEgyHi_14_12 "High energy battery cell voltages";
CM_ SG_ 75 UCellBattEgyHi_14_11 "High energy battery cell voltages";
CM_ SG_ 75 UCellBattEgyHi_14_10 "High energy battery cell voltages";
CM_ SG_ 75 UCellBattEgyHi_14_9 "High energy battery cell voltages";
CM_ SG_ 74 UCellBattEgyHi_14_8 "High energy battery cell voltages";
CM_ SG_ 74 UCellBattEgyHi_14_7 "High energy battery cell voltages";
CM_ SG_ 74 UCellBattEgyHi_14_6 "High energy battery cell voltages";
CM_ SG_ 74 UCellBattEgyHi_14_5 "High energy battery cell voltages";
CM_ SG_ 74 UCellBattEgyHi_14_4 "High energy battery cell voltages";
CM_ SG_ 74 UCellBattEgyHi_14_3 "High energy battery cell voltages";
CM_ SG_ 74 UCellBattEgyHi_14_2 "High energy battery cell voltages";
CM_ SG_ 74 UCellBattEgyHi_14_1 "High energy battery cell voltages";
CM_ SG_ 73 UCellBattEgyHi_13_16 "High energy battery cell voltages";
CM_ SG_ 73 UCellBattEgyHi_13_15 "High energy battery cell voltages";
CM_ SG_ 73 UCellBattEgyHi_13_14 "High energy battery cell voltages";
CM_ SG_ 73 UCellBattEgyHi_13_13 "High energy battery cell voltages";
CM_ SG_ 73 UCellBattEgyHi_13_12 "High energy battery cell voltages";
CM_ SG_ 73 UCellBattEgyHi_13_11 "High energy battery cell voltages";
CM_ SG_ 73 UCellBattEgyHi_13_10 "High energy battery cell voltages";
CM_ SG_ 73 UCellBattEgyHi_13_9 "High energy battery cell voltages";
CM_ SG_ 72 UCellBattEgyHi_13_8 "High energy battery cell voltages";
CM_ SG_ 72 UCellBattEgyHi_13_7 "High energy battery cell voltages";
CM_ SG_ 72 UCellBattEgyHi_13_6 "High energy battery cell voltages";
CM_ SG_ 72 UCellBattEgyHi_13_5 "High energy battery cell voltages";
CM_ SG_ 72 UCellBattEgyHi_13_4 "High energy battery cell voltages";
CM_ SG_ 72 UCellBattEgyHi_13_3 "High energy battery cell voltages";
CM_ SG_ 72 UCellBattEgyHi_13_2 "High energy battery cell voltages";
CM_ SG_ 72 UCellBattEgyHi_13_1 "High energy battery cell voltages";
CM_ SG_ 71 UCellBattEgyHi_12_16 "High energy battery cell voltages";
CM_ SG_ 71 UCellBattEgyHi_12_15 "High energy battery cell voltages";
CM_ SG_ 71 UCellBattEgyHi_12_14 "High energy battery cell voltages";
CM_ SG_ 71 UCellBattEgyHi_12_13 "High energy battery cell voltages";
CM_ SG_ 71 UCellBattEgyHi_12_12 "High energy battery cell voltages";
CM_ SG_ 71 UCellBattEgyHi_12_11 "High energy battery cell voltages";
CM_ SG_ 71 UCellBattEgyHi_12_10 "High energy battery cell voltages";
CM_ SG_ 71 UCellBattEgyHi_12_9 "High energy battery cell voltages";
CM_ SG_ 70 UCellBattEgyHi_12_8 "High energy battery cell voltages";
CM_ SG_ 70 UCellBattEgyHi_12_7 "High energy battery cell voltages";
CM_ SG_ 70 UCellBattEgyHi_12_6 "High energy battery cell voltages";
CM_ SG_ 70 UCellBattEgyHi_12_5 "High energy battery cell voltages";
CM_ SG_ 70 UCellBattEgyHi_12_4 "High energy battery cell voltages";
CM_ SG_ 70 UCellBattEgyHi_12_3 "High energy battery cell voltages";
CM_ SG_ 70 UCellBattEgyHi_12_2 "High energy battery cell voltages";
CM_ SG_ 70 UCellBattEgyHi_12_1 "High energy battery cell voltages";
CM_ SG_ 69 UCellBattEgyHi_11_16 "High energy battery cell voltages";
CM_ SG_ 69 UCellBattEgyHi_11_15 "High energy battery cell voltages";
CM_ SG_ 69 UCellBattEgyHi_11_14 "High energy battery cell voltages";
CM_ SG_ 69 UCellBattEgyHi_11_13 "High energy battery cell voltages";
CM_ SG_ 69 UCellBattEgyHi_11_12 "High energy battery cell voltages";
CM_ SG_ 69 UCellBattEgyHi_11_11 "High energy battery cell voltages";
CM_ SG_ 69 UCellBattEgyHi_11_10 "High energy battery cell voltages";
CM_ SG_ 69 UCellBattEgyHi_11_9 "High energy battery cell voltages";
CM_ SG_ 68 UCellBattEgyHi_11_8 "High energy battery cell voltages";
CM_ SG_ 68 UCellBattEgyHi_11_7 "High energy battery cell voltages";
CM_ SG_ 68 UCellBattEgyHi_11_6 "High energy battery cell voltages";
CM_ SG_ 68 UCellBattEgyHi_11_5 "High energy battery cell voltages";
CM_ SG_ 68 UCellBattEgyHi_11_4 "High energy battery cell voltages";
CM_ SG_ 68 UCellBattEgyHi_11_3 "High energy battery cell voltages";
CM_ SG_ 68 UCellBattEgyHi_11_2 "High energy battery cell voltages";
CM_ SG_ 68 UCellBattEgyHi_11_1 "High energy battery cell voltages";
CM_ SG_ 67 UCellBattEgyHi_10_16 "High energy battery cell voltages";
CM_ SG_ 67 UCellBattEgyHi_10_15 "High energy battery cell voltages";
CM_ SG_ 67 UCellBattEgyHi_10_14 "High energy battery cell voltages";
CM_ SG_ 67 UCellBattEgyHi_10_13 "High energy battery cell voltages";
CM_ SG_ 67 UCellBattEgyHi_10_12 "High energy battery cell voltages";
CM_ SG_ 67 UCellBattEgyHi_10_11 "High energy battery cell voltages";
CM_ SG_ 67 UCellBattEgyHi_10_10 "High energy battery cell voltages";
CM_ SG_ 67 UCellBattEgyHi_10_9 "High energy battery cell voltages";
CM_ SG_ 66 UCellBattEgyHi_10_8 "High energy battery cell voltages";
CM_ SG_ 66 UCellBattEgyHi_10_7 "High energy battery cell voltages";
CM_ SG_ 66 UCellBattEgyHi_10_6 "High energy battery cell voltages";
CM_ SG_ 66 UCellBattEgyHi_10_5 "High energy battery cell voltages";
CM_ SG_ 66 UCellBattEgyHi_10_4 "High energy battery cell voltages";
CM_ SG_ 66 UCellBattEgyHi_10_3 "High energy battery cell voltages";
CM_ SG_ 66 UCellBattEgyHi_10_2 "High energy battery cell voltages";
CM_ SG_ 66 UCellBattEgyHi_10_1 "High energy battery cell voltages";
CM_ SG_ 65 UCellBattEgyHi_9_16 "High energy battery cell voltages";
CM_ SG_ 65 UCellBattEgyHi_9_15 "High energy battery cell voltages";
CM_ SG_ 65 UCellBattEgyHi_9_14 "High energy battery cell voltages";
CM_ SG_ 65 UCellBattEgyHi_9_13 "High energy battery cell voltages";
CM_ SG_ 65 UCellBattEgyHi_9_12 "High energy battery cell voltages";
CM_ SG_ 65 UCellBattEgyHi_9_11 "High energy battery cell voltages";
CM_ SG_ 65 UCellBattEgyHi_9_10 "High energy battery cell voltages";
CM_ SG_ 65 UCellBattEgyHi_9_9 "High energy battery cell voltages";
CM_ SG_ 64 UCellBattEgyHi_9_8 "High energy battery cell voltages";
CM_ SG_ 64 UCellBattEgyHi_9_7 "High energy battery cell voltages";
CM_ SG_ 64 UCellBattEgyHi_9_6 "High energy battery cell voltages";
CM_ SG_ 64 UCellBattEgyHi_9_5 "High energy battery cell voltages";
CM_ SG_ 64 UCellBattEgyHi_9_4 "High energy battery cell voltages";
CM_ SG_ 64 UCellBattEgyHi_9_3 "High energy battery cell voltages";
CM_ SG_ 64 UCellBattEgyHi_9_2 "High energy battery cell voltages";
CM_ SG_ 64 UCellBattEgyHi_9_1 "High energy battery cell voltages";
CM_ SG_ 63 UCellBattEgyHi_8_16 "High energy battery cell voltages";
CM_ SG_ 63 UCellBattEgyHi_8_15 "High energy battery cell voltages";
CM_ SG_ 63 UCellBattEgyHi_8_14 "High energy battery cell voltages";
CM_ SG_ 63 UCellBattEgyHi_8_13 "High energy battery cell voltages";
CM_ SG_ 63 UCellBattEgyHi_8_12 "High energy battery cell voltages";
CM_ SG_ 63 UCellBattEgyHi_8_11 "High energy battery cell voltages";
CM_ SG_ 63 UCellBattEgyHi_8_10 "High energy battery cell voltages";
CM_ SG_ 63 UCellBattEgyHi_8_9 "High energy battery cell voltages";
CM_ SG_ 62 UCellBattEgyHi_8_8 "High energy battery cell voltages";
CM_ SG_ 62 UCellBattEgyHi_8_7 "High energy battery cell voltages";
CM_ SG_ 62 UCellBattEgyHi_8_6 "High energy battery cell voltages";
CM_ SG_ 62 UCellBattEgyHi_8_5 "High energy battery cell voltages";
CM_ SG_ 62 UCellBattEgyHi_8_4 "High energy battery cell voltages";
CM_ SG_ 62 UCellBattEgyHi_8_3 "High energy battery cell voltages";
CM_ SG_ 62 UCellBattEgyHi_8_2 "High energy battery cell voltages";
CM_ SG_ 62 UCellBattEgyHi_8_1 "High energy battery cell voltages";
CM_ SG_ 61 UCellBattEgyHi_7_16 "High energy battery cell voltages";
CM_ SG_ 61 UCellBattEgyHi_7_15 "High energy battery cell voltages";
CM_ SG_ 61 UCellBattEgyHi_7_14 "High energy battery cell voltages";
CM_ SG_ 61 UCellBattEgyHi_7_13 "High energy battery cell voltages";
CM_ SG_ 61 UCellBattEgyHi_7_12 "High energy battery cell voltages";
CM_ SG_ 61 UCellBattEgyHi_7_11 "High energy battery cell voltages";
CM_ SG_ 61 UCellBattEgyHi_7_10 "High energy battery cell voltages";
CM_ SG_ 61 UCellBattEgyHi_7_9 "High energy battery cell voltages";
CM_ SG_ 60 UCellBattEgyHi_7_8 "High energy battery cell voltages";
CM_ SG_ 60 UCellBattEgyHi_7_7 "High energy battery cell voltages";
CM_ SG_ 60 UCellBattEgyHi_7_6 "High energy battery cell voltages";
CM_ SG_ 60 UCellBattEgyHi_7_5 "High energy battery cell voltages";
CM_ SG_ 60 UCellBattEgyHi_7_4 "High energy battery cell voltages";
CM_ SG_ 60 UCellBattEgyHi_7_3 "High energy battery cell voltages";
CM_ SG_ 60 UCellBattEgyHi_7_2 "High energy battery cell voltages";
CM_ SG_ 60 UCellBattEgyHi_7_1 "High energy battery cell voltages";
CM_ SG_ 59 UCellBattEgyHi_6_16 "High energy battery cell voltages";
CM_ SG_ 59 UCellBattEgyHi_6_15 "High energy battery cell voltages";
CM_ SG_ 59 UCellBattEgyHi_6_14 "High energy battery cell voltages";
CM_ SG_ 59 UCellBattEgyHi_6_13 "High energy battery cell voltages";
CM_ SG_ 59 UCellBattEgyHi_6_12 "High energy battery cell voltages";
CM_ SG_ 59 UCellBattEgyHi_6_11 "High energy battery cell voltages";
CM_ SG_ 59 UCellBattEgyHi_6_10 "High energy battery cell voltages";
CM_ SG_ 59 UCellBattEgyHi_6_9 "High energy battery cell voltages";
CM_ SG_ 58 UCellBattEgyHi_6_8 "High energy battery cell voltages";
CM_ SG_ 58 UCellBattEgyHi_6_7 "High energy battery cell voltages";
CM_ SG_ 58 UCellBattEgyHi_6_6 "High energy battery cell voltages";
CM_ SG_ 58 UCellBattEgyHi_6_5 "High energy battery cell voltages";
CM_ SG_ 58 UCellBattEgyHi_6_4 "High energy battery cell voltages";
CM_ SG_ 58 UCellBattEgyHi_6_3 "High energy battery cell voltages";
CM_ SG_ 58 UCellBattEgyHi_6_2 "High energy battery cell voltages";
CM_ SG_ 58 UCellBattEgyHi_6_1 "High energy battery cell voltages";
CM_ SG_ 57 UCellBattEgyHi_5_16 "High energy battery cell voltages";
CM_ SG_ 57 UCellBattEgyHi_5_15 "High energy battery cell voltages";
CM_ SG_ 57 UCellBattEgyHi_5_14 "High energy battery cell voltages";
CM_ SG_ 57 UCellBattEgyHi_5_13 "High energy battery cell voltages";
CM_ SG_ 57 UCellBattEgyHi_5_12 "High energy battery cell voltages";
CM_ SG_ 57 UCellBattEgyHi_5_11 "High energy battery cell voltages";
CM_ SG_ 57 UCellBattEgyHi_5_10 "High energy battery cell voltages";
CM_ SG_ 57 UCellBattEgyHi_5_9 "High energy battery cell voltages";
CM_ SG_ 56 UCellBattEgyHi_5_8 "High energy battery cell voltages";
CM_ SG_ 56 UCellBattEgyHi_5_7 "High energy battery cell voltages";
CM_ SG_ 56 UCellBattEgyHi_5_6 "High energy battery cell voltages";
CM_ SG_ 56 UCellBattEgyHi_5_5 "High energy battery cell voltages";
CM_ SG_ 56 UCellBattEgyHi_5_4 "High energy battery cell voltages";
CM_ SG_ 56 UCellBattEgyHi_5_3 "High energy battery cell voltages";
CM_ SG_ 56 UCellBattEgyHi_5_2 "High energy battery cell voltages";
CM_ SG_ 56 UCellBattEgyHi_5_1 "High energy battery cell voltages";
CM_ SG_ 55 UCellBattEgyHi_4_16 "High energy battery cell voltages";
CM_ SG_ 55 UCellBattEgyHi_4_15 "High energy battery cell voltages";
CM_ SG_ 55 UCellBattEgyHi_4_14 "High energy battery cell voltages";
CM_ SG_ 55 UCellBattEgyHi_4_13 "High energy battery cell voltages";
CM_ SG_ 55 UCellBattEgyHi_4_12 "High energy battery cell voltages";
CM_ SG_ 55 UCellBattEgyHi_4_11 "High energy battery cell voltages";
CM_ SG_ 55 UCellBattEgyHi_4_10 "High energy battery cell voltages";
CM_ SG_ 55 UCellBattEgyHi_4_9 "High energy battery cell voltages";
CM_ SG_ 54 UCellBattEgyHi_4_8 "High energy battery cell voltages";
CM_ SG_ 54 UCellBattEgyHi_4_7 "High energy battery cell voltages";
CM_ SG_ 54 UCellBattEgyHi_4_6 "High energy battery cell voltages";
CM_ SG_ 54 UCellBattEgyHi_4_5 "High energy battery cell voltages";
CM_ SG_ 54 UCellBattEgyHi_4_4 "High energy battery cell voltages";
CM_ SG_ 54 UCellBattEgyHi_4_3 "High energy battery cell voltages";
CM_ SG_ 54 UCellBattEgyHi_4_2 "High energy battery cell voltages";
CM_ SG_ 54 UCellBattEgyHi_4_1 "High energy battery cell voltages";
CM_ SG_ 53 UCellBattEgyHi_3_16 "High energy battery cell voltages";
CM_ SG_ 53 UCellBattEgyHi_3_15 "High energy battery cell voltages";
CM_ SG_ 53 UCellBattEgyHi_3_14 "High energy battery cell voltages";
CM_ SG_ 53 UCellBattEgyHi_3_13 "High energy battery cell voltages";
CM_ SG_ 53 UCellBattEgyHi_3_12 "High energy battery cell voltages";
CM_ SG_ 53 UCellBattEgyHi_3_11 "High energy battery cell voltages";
CM_ SG_ 53 UCellBattEgyHi_3_10 "High energy battery cell voltages";
CM_ SG_ 53 UCellBattEgyHi_3_9 "High energy battery cell voltages";
CM_ SG_ 52 UCellBattEgyHi_3_8 "High energy battery cell voltages";
CM_ SG_ 52 UCellBattEgyHi_3_7 "High energy battery cell voltages";
CM_ SG_ 52 UCellBattEgyHi_3_6 "High energy battery cell voltages";
CM_ SG_ 52 UCellBattEgyHi_3_5 "High energy battery cell voltages";
CM_ SG_ 52 UCellBattEgyHi_3_4 "High energy battery cell voltages";
CM_ SG_ 52 UCellBattEgyHi_3_3 "High energy battery cell voltages";
CM_ SG_ 52 UCellBattEgyHi_3_2 "High energy battery cell voltages";
CM_ SG_ 52 UCellBattEgyHi_3_1 "High energy battery cell voltages";
CM_ SG_ 51 UCellBattEgyHi_2_16 "High energy battery cell voltages";
CM_ SG_ 51 UCellBattEgyHi_2_15 "High energy battery cell voltages";
CM_ SG_ 51 UCellBattEgyHi_2_14 "High energy battery cell voltages";
CM_ SG_ 51 UCellBattEgyHi_2_13 "High energy battery cell voltages";
CM_ SG_ 51 UCellBattEgyHi_2_12 "High energy battery cell voltages";
CM_ SG_ 51 UCellBattEgyHi_2_11 "High energy battery cell voltages";
CM_ SG_ 51 UCellBattEgyHi_2_10 "High energy battery cell voltages";
CM_ SG_ 51 UCellBattEgyHi_2_9 "High energy battery cell voltages";
CM_ SG_ 50 UCellBattEgyHi_2_8 "High energy battery cell voltages";
CM_ SG_ 50 UCellBattEgyHi_2_7 "High energy battery cell voltages";
CM_ SG_ 50 UCellBattEgyHi_2_6 "High energy battery cell voltages";
CM_ SG_ 50 UCellBattEgyHi_2_5 "High energy battery cell voltages";
CM_ SG_ 50 UCellBattEgyHi_2_4 "High energy battery cell voltages";
CM_ SG_ 50 UCellBattEgyHi_2_3 "High energy battery cell voltages";
CM_ SG_ 50 UCellBattEgyHi_2_2 "High energy battery cell voltages";
CM_ SG_ 50 UCellBattEgyHi_2_1 "High energy battery cell voltages";
CM_ SG_ 49 UCellBattEgyHi_1_9 "High energy battery cell voltages";
CM_ SG_ 49 UCellBattEgyHi_1_10 "High energy battery cell voltages";
CM_ SG_ 49 UCellBattEgyHi_1_11 "High energy battery cell voltages";
CM_ SG_ 49 UCellBattEgyHi_1_12 "High energy battery cell voltages";
CM_ SG_ 49 UCellBattEgyHi_1_13 "High energy battery cell voltages";
CM_ SG_ 49 UCellBattEgyHi_1_14 "High energy battery cell voltages";
CM_ SG_ 49 UCellBattEgyHi_1_15 "High energy battery cell voltages";
CM_ SG_ 49 UCellBattEgyHi_1_16 "High energy battery cell voltages";
CM_ SG_ 48 UCellBattEgyHi_1_7 "High energy battery cell voltages";
CM_ SG_ 48 UCellBattEgyHi_1_8 "High energy battery cell voltages";
CM_ SG_ 48 UCellBattEgyHi_1_6 "High energy battery cell voltages";
CM_ SG_ 48 UCellBattEgyHi_1_5 "High energy battery cell voltages";
CM_ SG_ 48 UCellBattEgyHi_1_4 "High energy battery cell voltages";
CM_ SG_ 48 UCellBattEgyHi_1_3 "High energy battery cell voltages";
CM_ SG_ 48 UCellBattEgyHi_1_2 "High energy battery cell voltages";
CM_ SG_ 48 UCellBattEgyHi_1_1 "High energy battery cell voltages";
CM_ SG_ 47 UCellBattPwrHi_16_16 "High power battery cell voltages";
CM_ SG_ 47 UCellBattPwrHi_16_15 "High power battery cell voltages";
CM_ SG_ 47 UCellBattPwrHi_16_14 "High power battery cell voltages";
CM_ SG_ 47 UCellBattPwrHi_16_13 "High power battery cell voltages";
CM_ SG_ 47 UCellBattPwrHi_16_12 "High power battery cell voltages";
CM_ SG_ 47 UCellBattPwrHi_16_11 "High power battery cell voltages";
CM_ SG_ 47 UCellBattPwrHi_16_10 "High power battery cell voltages";
CM_ SG_ 47 UCellBattPwrHi_16_9 "High power battery cell voltages";
CM_ SG_ 46 UCellBattPwrHi_16_8 "High power battery cell voltages";
CM_ SG_ 46 UCellBattPwrHi_16_7 "High power battery cell voltages";
CM_ SG_ 46 UCellBattPwrHi_16_6 "High power battery cell voltages";
CM_ SG_ 46 UCellBattPwrHi_16_5 "High power battery cell voltages";
CM_ SG_ 46 UCellBattPwrHi_16_4 "High power battery cell voltages";
CM_ SG_ 46 UCellBattPwrHi_16_3 "High power battery cell voltages";
CM_ SG_ 46 UCellBattPwrHi_16_2 "High power battery cell voltages";
CM_ SG_ 46 UCellBattPwrHi_16_1 "High power battery cell voltages";
CM_ SG_ 45 UCellBattPwrHi_15_16 "High power battery cell voltages";
CM_ SG_ 45 UCellBattPwrHi_15_15 "High power battery cell voltages";
CM_ SG_ 45 UCellBattPwrHi_15_14 "High power battery cell voltages";
CM_ SG_ 45 UCellBattPwrHi_15_13 "High power battery cell voltages";
CM_ SG_ 45 UCellBattPwrHi_15_12 "High power battery cell voltages";
CM_ SG_ 45 UCellBattPwrHi_15_11 "High power battery cell voltages";
CM_ SG_ 45 UCellBattPwrHi_15_10 "High power battery cell voltages";
CM_ SG_ 45 UCellBattPwrHi_15_9 "High power battery cell voltages";
CM_ SG_ 44 UCellBattPwrHi_15_8 "High power battery cell voltages";
CM_ SG_ 44 UCellBattPwrHi_15_7 "High power battery cell voltages";
CM_ SG_ 44 UCellBattPwrHi_15_6 "High power battery cell voltages";
CM_ SG_ 44 UCellBattPwrHi_15_5 "High power battery cell voltages";
CM_ SG_ 44 UCellBattPwrHi_15_4 "High power battery cell voltages";
CM_ SG_ 44 UCellBattPwrHi_15_3 "High power battery cell voltages";
CM_ SG_ 44 UCellBattPwrHi_15_2 "High power battery cell voltages";
CM_ SG_ 44 UCellBattPwrHi_15_1 "High power battery cell voltages";
CM_ SG_ 43 UCellBattPwrHi_14_16 "High power battery cell voltages";
CM_ SG_ 43 UCellBattPwrHi_14_15 "High power battery cell voltages";
CM_ SG_ 43 UCellBattPwrHi_14_14 "High power battery cell voltages";
CM_ SG_ 43 UCellBattPwrHi_14_13 "High power battery cell voltages";
CM_ SG_ 43 UCellBattPwrHi_14_12 "High power battery cell voltages";
CM_ SG_ 43 UCellBattPwrHi_14_11 "High power battery cell voltages";
CM_ SG_ 43 UCellBattPwrHi_14_10 "High power battery cell voltages";
CM_ SG_ 43 UCellBattPwrHi_14_9 "High power battery cell voltages";
CM_ SG_ 42 UCellBattPwrHi_14_8 "High power battery cell voltages";
CM_ SG_ 42 UCellBattPwrHi_14_7 "High power battery cell voltages";
CM_ SG_ 42 UCellBattPwrHi_14_6 "High power battery cell voltages";
CM_ SG_ 42 UCellBattPwrHi_14_5 "High power battery cell voltages";
CM_ SG_ 42 UCellBattPwrHi_14_4 "High power battery cell voltages";
CM_ SG_ 42 UCellBattPwrHi_14_3 "High power battery cell voltages";
CM_ SG_ 42 UCellBattPwrHi_14_2 "High power battery cell voltages";
CM_ SG_ 42 UCellBattPwrHi_14_1 "High power battery cell voltages";
CM_ SG_ 41 UCellBattPwrHi_13_16 "High power battery cell voltages";
CM_ SG_ 41 UCellBattPwrHi_13_15 "High power battery cell voltages";
CM_ SG_ 41 UCellBattPwrHi_13_14 "High power battery cell voltages";
CM_ SG_ 41 UCellBattPwrHi_13_13 "High power battery cell voltages";
CM_ SG_ 41 UCellBattPwrHi_13_12 "High power battery cell voltages";
CM_ SG_ 41 UCellBattPwrHi_13_11 "High power battery cell voltages";
CM_ SG_ 41 UCellBattPwrHi_13_10 "High power battery cell voltages";
CM_ SG_ 41 UCellBattPwrHi_13_9 "High power battery cell voltages";
CM_ SG_ 40 UCellBattPwrHi_13_8 "High power battery cell voltages";
CM_ SG_ 40 UCellBattPwrHi_13_7 "High power battery cell voltages";
CM_ SG_ 40 UCellBattPwrHi_13_6 "High power battery cell voltages";
CM_ SG_ 40 UCellBattPwrHi_13_5 "High power battery cell voltages";
CM_ SG_ 40 UCellBattPwrHi_13_4 "High power battery cell voltages";
CM_ SG_ 40 UCellBattPwrHi_13_3 "High power battery cell voltages";
CM_ SG_ 40 UCellBattPwrHi_13_2 "High power battery cell voltages";
CM_ SG_ 40 UCellBattPwrHi_13_1 "High power battery cell voltages";
CM_ SG_ 39 UCellBattPwrHi_12_16 "High power battery cell voltages";
CM_ SG_ 39 UCellBattPwrHi_12_15 "High power battery cell voltages";
CM_ SG_ 39 UCellBattPwrHi_12_14 "High power battery cell voltages";
CM_ SG_ 39 UCellBattPwrHi_12_13 "High power battery cell voltages";
CM_ SG_ 39 UCellBattPwrHi_12_12 "High power battery cell voltages";
CM_ SG_ 39 UCellBattPwrHi_12_11 "High power battery cell voltages";
CM_ SG_ 39 UCellBattPwrHi_12_10 "High power battery cell voltages";
CM_ SG_ 39 UCellBattPwrHi_12_9 "High power battery cell voltages";
CM_ SG_ 38 UCellBattPwrHi_12_8 "High power battery cell voltages";
CM_ SG_ 38 UCellBattPwrHi_12_7 "High power battery cell voltages";
CM_ SG_ 38 UCellBattPwrHi_12_6 "High power battery cell voltages";
CM_ SG_ 38 UCellBattPwrHi_12_5 "High power battery cell voltages";
CM_ SG_ 38 UCellBattPwrHi_12_4 "High power battery cell voltages";
CM_ SG_ 38 UCellBattPwrHi_12_3 "High power battery cell voltages";
CM_ SG_ 38 UCellBattPwrHi_12_2 "High power battery cell voltages";
CM_ SG_ 38 UCellBattPwrHi_12_1 "High power battery cell voltages";
CM_ SG_ 37 UCellBattPwrHi_11_16 "High power battery cell voltages";
CM_ SG_ 37 UCellBattPwrHi_11_15 "High power battery cell voltages";
CM_ SG_ 37 UCellBattPwrHi_11_14 "High power battery cell voltages";
CM_ SG_ 37 UCellBattPwrHi_11_13 "High power battery cell voltages";
CM_ SG_ 37 UCellBattPwrHi_11_12 "High power battery cell voltages";
CM_ SG_ 37 UCellBattPwrHi_11_11 "High power battery cell voltages";
CM_ SG_ 37 UCellBattPwrHi_11_10 "High power battery cell voltages";
CM_ SG_ 37 UCellBattPwrHi_11_9 "High power battery cell voltages";
CM_ SG_ 36 UCellBattPwrHi_11_8 "High power battery cell voltages";
CM_ SG_ 36 UCellBattPwrHi_11_7 "High power battery cell voltages";
CM_ SG_ 36 UCellBattPwrHi_11_6 "High power battery cell voltages";
CM_ SG_ 36 UCellBattPwrHi_11_5 "High power battery cell voltages";
CM_ SG_ 36 UCellBattPwrHi_11_4 "High power battery cell voltages";
CM_ SG_ 36 UCellBattPwrHi_11_3 "High power battery cell voltages";
CM_ SG_ 36 UCellBattPwrHi_11_2 "High power battery cell voltages";
CM_ SG_ 36 UCellBattPwrHi_11_1 "High power battery cell voltages";
CM_ SG_ 35 UCellBattPwrHi_10_16 "High power battery cell voltages";
CM_ SG_ 35 UCellBattPwrHi_10_15 "High power battery cell voltages";
CM_ SG_ 35 UCellBattPwrHi_10_14 "High power battery cell voltages";
CM_ SG_ 35 UCellBattPwrHi_10_13 "High power battery cell voltages";
CM_ SG_ 35 UCellBattPwrHi_10_12 "High power battery cell voltages";
CM_ SG_ 35 UCellBattPwrHi_10_11 "High power battery cell voltages";
CM_ SG_ 35 UCellBattPwrHi_10_10 "High power battery cell voltages";
CM_ SG_ 35 UCellBattPwrHi_10_9 "High power battery cell voltages";
CM_ SG_ 34 UCellBattPwrHi_10_8 "High power battery cell voltages";
CM_ SG_ 34 UCellBattPwrHi_10_7 "High power battery cell voltages";
CM_ SG_ 34 UCellBattPwrHi_10_6 "High power battery cell voltages";
CM_ SG_ 34 UCellBattPwrHi_10_5 "High power battery cell voltages";
CM_ SG_ 34 UCellBattPwrHi_10_4 "High power battery cell voltages";
CM_ SG_ 34 UCellBattPwrHi_10_3 "High power battery cell voltages";
CM_ SG_ 34 UCellBattPwrHi_10_2 "High power battery cell voltages";
CM_ SG_ 34 UCellBattPwrHi_10_1 "High power battery cell voltages";
CM_ SG_ 33 UCellBattPwrHi_9_16 "High power battery cell voltages";
CM_ SG_ 33 UCellBattPwrHi_9_15 "High power battery cell voltages";
CM_ SG_ 33 UCellBattPwrHi_9_14 "High power battery cell voltages";
CM_ SG_ 33 UCellBattPwrHi_9_13 "High power battery cell voltages";
CM_ SG_ 33 UCellBattPwrHi_9_12 "High power battery cell voltages";
CM_ SG_ 33 UCellBattPwrHi_9_11 "High power battery cell voltages";
CM_ SG_ 33 UCellBattPwrHi_9_10 "High power battery cell voltages";
CM_ SG_ 33 UCellBattPwrHi_9_9 "High power battery cell voltages";
CM_ SG_ 32 UCellBattPwrHi_9_8 "High power battery cell voltages";
CM_ SG_ 32 UCellBattPwrHi_9_7 "High power battery cell voltages";
CM_ SG_ 32 UCellBattPwrHi_9_6 "High power battery cell voltages";
CM_ SG_ 32 UCellBattPwrHi_9_5 "High power battery cell voltages";
CM_ SG_ 32 UCellBattPwrHi_9_4 "High power battery cell voltages";
CM_ SG_ 32 UCellBattPwrHi_9_3 "High power battery cell voltages";
CM_ SG_ 32 UCellBattPwrHi_9_2 "High power battery cell voltages";
CM_ SG_ 32 UCellBattPwrHi_9_1 "High power battery cell voltages";
CM_ SG_ 31 UCellBattPwrHi_8_16 "High power battery cell voltages";
CM_ SG_ 31 UCellBattPwrHi_8_15 "High power battery cell voltages";
CM_ SG_ 31 UCellBattPwrHi_8_14 "High power battery cell voltages";
CM_ SG_ 31 UCellBattPwrHi_8_13 "High power battery cell voltages";
CM_ SG_ 31 UCellBattPwrHi_8_12 "High power battery cell voltages";
CM_ SG_ 31 UCellBattPwrHi_8_11 "High power battery cell voltages";
CM_ SG_ 31 UCellBattPwrHi_8_10 "High power battery cell voltages";
CM_ SG_ 31 UCellBattPwrHi_8_9 "High power battery cell voltages";
CM_ SG_ 30 UCellBattPwrHi_8_8 "High power battery cell voltages";
CM_ SG_ 30 UCellBattPwrHi_8_7 "High power battery cell voltages";
CM_ SG_ 30 UCellBattPwrHi_8_6 "High power battery cell voltages";
CM_ SG_ 30 UCellBattPwrHi_8_5 "High power battery cell voltages";
CM_ SG_ 30 UCellBattPwrHi_8_4 "High power battery cell voltages";
CM_ SG_ 30 UCellBattPwrHi_8_3 "High power battery cell voltages";
CM_ SG_ 30 UCellBattPwrHi_8_2 "High power battery cell voltages";
CM_ SG_ 30 UCellBattPwrHi_8_1 "High power battery cell voltages";
CM_ SG_ 29 UCellBattPwrHi_7_16 "High power battery cell voltages";
CM_ SG_ 29 UCellBattPwrHi_7_15 "High power battery cell voltages";
CM_ SG_ 29 UCellBattPwrHi_7_14 "High power battery cell voltages";
CM_ SG_ 29 UCellBattPwrHi_7_13 "High power battery cell voltages";
CM_ SG_ 29 UCellBattPwrHi_7_12 "High power battery cell voltages";
CM_ SG_ 29 UCellBattPwrHi_7_11 "High power battery cell voltages";
CM_ SG_ 29 UCellBattPwrHi_7_10 "High power battery cell voltages";
CM_ SG_ 29 UCellBattPwrHi_7_9 "High power battery cell voltages";
CM_ SG_ 28 UCellBattPwrHi_7_8 "High power battery cell voltages";
CM_ SG_ 28 UCellBattPwrHi_7_7 "High power battery cell voltages";
CM_ SG_ 28 UCellBattPwrHi_7_6 "High power battery cell voltages";
CM_ SG_ 28 UCellBattPwrHi_7_5 "High power battery cell voltages";
CM_ SG_ 28 UCellBattPwrHi_7_4 "High power battery cell voltages";
CM_ SG_ 28 UCellBattPwrHi_7_3 "High power battery cell voltages";
CM_ SG_ 28 UCellBattPwrHi_7_2 "High power battery cell voltages";
CM_ SG_ 28 UCellBattPwrHi_7_1 "High power battery cell voltages";
CM_ SG_ 27 UCellBattPwrHi_6_16 "High power battery cell voltages";
CM_ SG_ 27 UCellBattPwrHi_6_15 "High power battery cell voltages";
CM_ SG_ 27 UCellBattPwrHi_6_14 "High power battery cell voltages";
CM_ SG_ 27 UCellBattPwrHi_6_13 "High power battery cell voltages";
CM_ SG_ 27 UCellBattPwrHi_6_12 "High power battery cell voltages";
CM_ SG_ 27 UCellBattPwrHi_6_11 "High power battery cell voltages";
CM_ SG_ 27 UCellBattPwrHi_6_10 "High power battery cell voltages";
CM_ SG_ 27 UCellBattPwrHi_6_9 "High power battery cell voltages";
CM_ SG_ 26 UCellBattPwrHi_6_8 "High power battery cell voltages";
CM_ SG_ 26 UCellBattPwrHi_6_7 "High power battery cell voltages";
CM_ SG_ 26 UCellBattPwrHi_6_6 "High power battery cell voltages";
CM_ SG_ 26 UCellBattPwrHi_6_5 "High power battery cell voltages";
CM_ SG_ 26 UCellBattPwrHi_6_4 "High power battery cell voltages";
CM_ SG_ 26 UCellBattPwrHi_6_3 "High power battery cell voltages";
CM_ SG_ 26 UCellBattPwrHi_6_2 "High power battery cell voltages";
CM_ SG_ 26 UCellBattPwrHi_6_1 "High power battery cell voltages";
CM_ SG_ 25 UCellBattPwrHi_5_16 "High power battery cell voltages";
CM_ SG_ 25 UCellBattPwrHi_5_15 "High power battery cell voltages";
CM_ SG_ 25 UCellBattPwrHi_5_14 "High power battery cell voltages";
CM_ SG_ 25 UCellBattPwrHi_5_13 "High power battery cell voltages";
CM_ SG_ 25 UCellBattPwrHi_5_12 "High power battery cell voltages";
CM_ SG_ 25 UCellBattPwrHi_5_11 "High power battery cell voltages";
CM_ SG_ 25 UCellBattPwrHi_5_10 "High power battery cell voltages";
CM_ SG_ 25 UCellBattPwrHi_5_9 "High power battery cell voltages";
CM_ SG_ 24 UCellBattPwrHi_5_8 "High power battery cell voltages";
CM_ SG_ 24 UCellBattPwrHi_5_7 "High power battery cell voltages";
CM_ SG_ 24 UCellBattPwrHi_5_6 "High power battery cell voltages";
CM_ SG_ 24 UCellBattPwrHi_5_5 "High power battery cell voltages";
CM_ SG_ 24 UCellBattPwrHi_5_4 "High power battery cell voltages";
CM_ SG_ 24 UCellBattPwrHi_5_3 "High power battery cell voltages";
CM_ SG_ 24 UCellBattPwrHi_5_2 "High power battery cell voltages";
CM_ SG_ 24 UCellBattPwrHi_5_1 "High power battery cell voltages";
CM_ SG_ 23 UCellBattPwrHi_4_16 "High power battery cell voltages";
CM_ SG_ 23 UCellBattPwrHi_4_15 "High power battery cell voltages";
CM_ SG_ 23 UCellBattPwrHi_4_14 "High power battery cell voltages";
CM_ SG_ 23 UCellBattPwrHi_4_13 "High power battery cell voltages";
CM_ SG_ 23 UCellBattPwrHi_4_12 "High power battery cell voltages";
CM_ SG_ 23 UCellBattPwrHi_4_11 "High power battery cell voltages";
CM_ SG_ 23 UCellBattPwrHi_4_10 "High power battery cell voltages";
CM_ SG_ 23 UCellBattPwrHi_4_9 "High power battery cell voltages";
CM_ SG_ 22 UCellBattPwrHi_4_8 "High power battery cell voltages";
CM_ SG_ 22 UCellBattPwrHi_4_7 "High power battery cell voltages";
CM_ SG_ 22 UCellBattPwrHi_4_6 "High power battery cell voltages";
CM_ SG_ 22 UCellBattPwrHi_4_5 "High power battery cell voltages";
CM_ SG_ 22 UCellBattPwrHi_4_4 "High power battery cell voltages";
CM_ SG_ 22 UCellBattPwrHi_4_3 "High power battery cell voltages";
CM_ SG_ 22 UCellBattPwrHi_4_2 "High power battery cell voltages";
CM_ SG_ 22 UCellBattPwrHi_4_1 "High power battery cell voltages";
CM_ SG_ 21 UCellBattPwrHi_3_16 "High power battery cell voltages";
CM_ SG_ 21 UCellBattPwrHi_3_15 "High power battery cell voltages";
CM_ SG_ 21 UCellBattPwrHi_3_14 "High power battery cell voltages";
CM_ SG_ 21 UCellBattPwrHi_3_13 "High power battery cell voltages";
CM_ SG_ 21 UCellBattPwrHi_3_12 "High power battery cell voltages";
CM_ SG_ 21 UCellBattPwrHi_3_11 "High power battery cell voltages";
CM_ SG_ 21 UCellBattPwrHi_3_10 "High power battery cell voltages";
CM_ SG_ 21 UCellBattPwrHi_3_9 "High power battery cell voltages";
CM_ SG_ 20 UCellBattPwrHi_3_8 "High power battery cell voltages";
CM_ SG_ 20 UCellBattPwrHi_3_7 "High power battery cell voltages";
CM_ SG_ 20 UCellBattPwrHi_3_6 "High power battery cell voltages";
CM_ SG_ 20 UCellBattPwrHi_3_5 "High power battery cell voltages";
CM_ SG_ 20 UCellBattPwrHi_3_4 "High power battery cell voltages";
CM_ SG_ 20 UCellBattPwrHi_3_3 "High power battery cell voltages";
CM_ SG_ 20 UCellBattPwrHi_3_2 "High power battery cell voltages";
CM_ SG_ 20 UCellBattPwrHi_3_1 "High power battery cell voltages";
CM_ SG_ 19 UCellBattPwrHi_2_16 "High power battery cell voltages";
CM_ SG_ 19 UCellBattPwrHi_2_15 "High power battery cell voltages";
CM_ SG_ 19 UCellBattPwrHi_2_14 "High power battery cell voltages";
CM_ SG_ 19 UCellBattPwrHi_2_13 "High power battery cell voltages";
CM_ SG_ 19 UCellBattPwrHi_2_12 "High power battery cell voltages";
CM_ SG_ 19 UCellBattPwrHi_2_11 "High power battery cell voltages";
CM_ SG_ 19 UCellBattPwrHi_2_10 "High power battery cell voltages";
CM_ SG_ 19 UCellBattPwrHi_2_9 "High power battery cell voltages";
CM_ SG_ 18 UCellBattPwrHi_2_8 "High power battery cell voltages";
CM_ SG_ 18 UCellBattPwrHi_2_7 "High power battery cell voltages";
CM_ SG_ 18 UCellBattPwrHi_2_6 "High power battery cell voltages";
CM_ SG_ 18 UCellBattPwrHi_2_5 "High power battery cell voltages";
CM_ SG_ 18 UCellBattPwrHi_2_4 "High power battery cell voltages";
CM_ SG_ 18 UCellBattPwrHi_2_3 "High power battery cell voltages";
CM_ SG_ 18 UCellBattPwrHi_2_2 "High power battery cell voltages";
CM_ SG_ 18 UCellBattPwrHi_2_1 "High power battery cell voltages";
CM_ SG_ 17 UCellBattPwrHi_1_16 "High power battery cell voltages";
CM_ SG_ 17 UCellBattPwrHi_1_15 "High power battery cell voltages";
CM_ SG_ 17 UCellBattPwrHi_1_14 "High power battery cell voltages";
CM_ SG_ 17 UCellBattPwrHi_1_13 "High power battery cell voltages";
CM_ SG_ 17 UCellBattPwrHi_1_12 "High power battery cell voltages";
CM_ SG_ 17 UCellBattPwrHi_1_11 "High power battery cell voltages";
CM_ SG_ 17 UCellBattPwrHi_1_10 "High power battery cell voltages";
CM_ SG_ 17 UCellBattPwrHi_1_9 "High power battery cell voltages";
CM_ SG_ 16 UCellBattPwrHi_1_8 "High power battery cell voltages";
CM_ SG_ 16 UCellBattPwrHi_1_7 "High power battery cell voltages";
CM_ SG_ 16 UCellBattPwrHi_1_6 "High power battery cell voltages";
CM_ SG_ 16 UCellBattPwrHi_1_5 "High power battery cell voltages";
CM_ SG_ 16 UCellBattPwrHi_1_4 "High power battery cell voltages";
CM_ SG_ 16 UCellBattPwrHi_1_3 "High power battery cell voltages";
CM_ SG_ 16 UCellBattPwrHi_1_2 "High power battery cell voltages";
CM_ SG_ 16 UCellBattPwrHi_1_1 "High power battery cell voltages";
BA_DEF_ BO_  "GenMsgSendType" ENUM  "Cyclic";
BA_DEF_ SG_  "GenSigSendType" ENUM  "Cyclic";
BA_DEF_ BO_  "GenMsgCycleTime" INT 0 65535;
BA_DEF_ BO_  "CANFD_BRS" ENUM  "0","1";
BA_DEF_ BO_  "VFrameFormat" ENUM  "StandardCAN","ExtendedCAN","reserved","reserved","reserved","reserved","reserved","reserved","reserved","reserved","reserved","reserved","reserved","reserved","StandardCAN_FD","ExtendedCAN_FD";
BA_DEF_DEF_  "GenMsgSendType" "Cyclic";
BA_DEF_DEF_  "GenSigSendType" "Cyclic";
BA_DEF_DEF_  "GenMsgCycleTime" 1000;
BA_DEF_DEF_  "CANFD_BRS" "1";
BA_DEF_DEF_  "VFrameFormat" "StandardCAN";
BA_ "VFrameFormat" BO_ 112 14;
BA_ "VFrameFormat" BO_ 107 14;
BA_ "VFrameFormat" BO_ 106 14;
BA_ "VFrameFormat" BO_ 105 14;
BA_ "VFrameFormat" BO_ 104 14;
BA_ "VFrameFormat" BO_ 103 14;
BA_ "VFrameFormat" BO_ 102 14;
BA_ "VFrameFormat" BO_ 101 14;
BA_ "VFrameFormat" BO_ 100 14;
BA_ "VFrameFormat" BO_ 99 14;
BA_ "VFrameFormat" BO_ 98 14;
BA_ "VFrameFormat" BO_ 97 14;
BA_ "VFrameFormat" BO_ 96 14;
BA_ "VFrameFormat" BO_ 91 14;
BA_ "VFrameFormat" BO_ 90 14;
BA_ "VFrameFormat" BO_ 89 14;
BA_ "VFrameFormat" BO_ 88 14;
BA_ "VFrameFormat" BO_ 87 14;
BA_ "VFrameFormat" BO_ 86 14;
BA_ "VFrameFormat" BO_ 85 14;
BA_ "VFrameFormat" BO_ 84 14;
BA_ "VFrameFormat" BO_ 83 14;
BA_ "VFrameFormat" BO_ 82 14;
BA_ "VFrameFormat" BO_ 81 14;
BA_ "VFrameFormat" BO_ 80 14;
BA_ "VFrameFormat" BO_ 79 14;
BA_ "VFrameFormat" BO_ 78 14;
BA_ "VFrameFormat" BO_ 77 14;
BA_ "VFrameFormat" BO_ 76 14;
BA_ "VFrameFormat" BO_ 75 14;
BA_ "VFrameFormat" BO_ 74 14;
BA_ "VFrameFormat" BO_ 73 14;
BA_ "VFrameFormat" BO_ 72 14;
BA_ "VFrameFormat" BO_ 71 14;
BA_ "VFrameFormat" BO_ 70 14;
BA_ "VFrameFormat" BO_ 69 14;
BA_ "VFrameFormat" BO_ 68 14;
BA_ "VFrameFormat" BO_ 67 14;
BA_ "VFrameFormat" BO_ 66 14;
BA_ "VFrameFormat" BO_ 65 14;
BA_ "VFrameFormat" BO_ 64 14;
BA_ "VFrameFormat" BO_ 63 14;
BA_ "VFrameFormat" BO_ 62 14;
BA_ "VFrameFormat" BO_ 61 14;
BA_ "VFrameFormat" BO_ 60 14;
BA_ "VFrameFormat" BO_ 59 14;
BA_ "VFrameFormat" BO_ 58 14;
BA_ "VFrameFormat" BO_ 57 14;
BA_ "VFrameFormat" BO_ 56 14;
BA_ "VFrameFormat" BO_ 55 14;
BA_ "VFrameFormat" BO_ 54 14;
BA_ "VFrameFormat" BO_ 53 14;
BA_ "VFrameFormat" BO_ 52 14;
BA_ "VFrameFormat" BO_ 51 14;
BA_ "VFrameFormat" BO_ 50 14;
BA_ "VFrameFormat" BO_ 49 14;
BA_ "VFrameFormat" BO_ 48 14;
BA_ "VFrameFormat" BO_ 47 14;
BA_ "VFrameFormat" BO_ 46 14;
BA_ "VFrameFormat" BO_ 45 14;
BA_ "VFrameFormat" BO_ 44 14;
BA_ "VFrameFormat" BO_ 43 14;
BA_ "VFrameFormat" BO_ 42 14;
BA_ "VFrameFormat" BO_ 41 14;
BA_ "VFrameFormat" BO_ 40 14;
BA_ "VFrameFormat" BO_ 39 14;
BA_ "VFrameFormat" BO_ 38 14;
BA_ "VFrameFormat" BO_ 37 14;
BA_ "VFrameFormat" BO_ 36 14;
BA_ "VFrameFormat" BO_ 35 14;
BA_ "VFrameFormat" BO_ 34 14;
BA_ "VFrameFormat" BO_ 33 14;
BA_ "VFrameFormat" BO_ 32 14;
BA_ "VFrameFormat" BO_ 31 14;
BA_ "VFrameFormat" BO_ 30 14;
BA_ "VFrameFormat" BO_ 29 14;
BA_ "VFrameFormat" BO_ 28 14;
BA_ "VFrameFormat" BO_ 27 14;
BA_ "VFrameFormat" BO_ 26 14;
BA_ "VFrameFormat" BO_ 25 14;
BA_ "VFrameFormat" BO_ 24 14;
BA_ "VFrameFormat" BO_ 23 14;
BA_ "VFrameFormat" BO_ 22 14;
BA_ "VFrameFormat" BO_ 21 14;
BA_ "VFrameFormat" BO_ 20 14;
BA_ "VFrameFormat" BO_ 19 14;
BA_ "VFrameFormat" BO_ 18 14;
BA_ "VFrameFormat" BO_ 17 14;
BA_ "VFrameFormat" BO_ 16 14;
